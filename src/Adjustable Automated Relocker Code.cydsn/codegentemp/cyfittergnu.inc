/*******************************************************************************
* File Name: cyfittergnu.inc
* 
* PSoC Creator  4.2
*
* Description:
* 
* This file is automatically generated by PSoC Creator.
*
********************************************************************************
* Copyright (c) 2007-2018 Cypress Semiconductor.  All rights reserved.
* You may use this file only in accordance with the license, terms, conditions, 
* disclaimers, and limitations in the end user license agreement accompanying 
* the software package with which this file was provided.
********************************************************************************/

.ifndef INCLUDED_CYFITTERGNU_INC
.set INCLUDED_CYFITTERGNU_INC, 1
.include "cydevicegnu.inc"
.include "cydevicegnu_trm.inc"

/* aPin */
.set aPin__0__INTTYPE, CYREG_PICU0_INTTYPE7
.set aPin__0__MASK, 0x80
.set aPin__0__PC, CYREG_PRT0_PC7
.set aPin__0__PORT, 0
.set aPin__0__SHIFT, 7
.set aPin__AG, CYREG_PRT0_AG
.set aPin__AMUX, CYREG_PRT0_AMUX
.set aPin__BIE, CYREG_PRT0_BIE
.set aPin__BIT_MASK, CYREG_PRT0_BIT_MASK
.set aPin__BYP, CYREG_PRT0_BYP
.set aPin__CTL, CYREG_PRT0_CTL
.set aPin__DM0, CYREG_PRT0_DM0
.set aPin__DM1, CYREG_PRT0_DM1
.set aPin__DM2, CYREG_PRT0_DM2
.set aPin__DR, CYREG_PRT0_DR
.set aPin__INP_DIS, CYREG_PRT0_INP_DIS
.set aPin__INTTYPE_BASE, CYDEV_PICU_INTTYPE_PICU0_BASE
.set aPin__LCD_COM_SEG, CYREG_PRT0_LCD_COM_SEG
.set aPin__LCD_EN, CYREG_PRT0_LCD_EN
.set aPin__MASK, 0x80
.set aPin__PORT, 0
.set aPin__PRT, CYREG_PRT0_PRT
.set aPin__PRTDSI__CAPS_SEL, CYREG_PRT0_CAPS_SEL
.set aPin__PRTDSI__DBL_SYNC_IN, CYREG_PRT0_DBL_SYNC_IN
.set aPin__PRTDSI__OE_SEL0, CYREG_PRT0_OE_SEL0
.set aPin__PRTDSI__OE_SEL1, CYREG_PRT0_OE_SEL1
.set aPin__PRTDSI__OUT_SEL0, CYREG_PRT0_OUT_SEL0
.set aPin__PRTDSI__OUT_SEL1, CYREG_PRT0_OUT_SEL1
.set aPin__PRTDSI__SYNC_OUT, CYREG_PRT0_SYNC_OUT
.set aPin__PS, CYREG_PRT0_PS
.set aPin__SHIFT, 7
.set aPin__SLW, CYREG_PRT0_SLW

/* bPin */
.set bPin__0__INTTYPE, CYREG_PICU0_INTTYPE5
.set bPin__0__MASK, 0x20
.set bPin__0__PC, CYREG_PRT0_PC5
.set bPin__0__PORT, 0
.set bPin__0__SHIFT, 5
.set bPin__AG, CYREG_PRT0_AG
.set bPin__AMUX, CYREG_PRT0_AMUX
.set bPin__BIE, CYREG_PRT0_BIE
.set bPin__BIT_MASK, CYREG_PRT0_BIT_MASK
.set bPin__BYP, CYREG_PRT0_BYP
.set bPin__CTL, CYREG_PRT0_CTL
.set bPin__DM0, CYREG_PRT0_DM0
.set bPin__DM1, CYREG_PRT0_DM1
.set bPin__DM2, CYREG_PRT0_DM2
.set bPin__DR, CYREG_PRT0_DR
.set bPin__INP_DIS, CYREG_PRT0_INP_DIS
.set bPin__INTTYPE_BASE, CYDEV_PICU_INTTYPE_PICU0_BASE
.set bPin__LCD_COM_SEG, CYREG_PRT0_LCD_COM_SEG
.set bPin__LCD_EN, CYREG_PRT0_LCD_EN
.set bPin__MASK, 0x20
.set bPin__PORT, 0
.set bPin__PRT, CYREG_PRT0_PRT
.set bPin__PRTDSI__CAPS_SEL, CYREG_PRT0_CAPS_SEL
.set bPin__PRTDSI__DBL_SYNC_IN, CYREG_PRT0_DBL_SYNC_IN
.set bPin__PRTDSI__OE_SEL0, CYREG_PRT0_OE_SEL0
.set bPin__PRTDSI__OE_SEL1, CYREG_PRT0_OE_SEL1
.set bPin__PRTDSI__OUT_SEL0, CYREG_PRT0_OUT_SEL0
.set bPin__PRTDSI__OUT_SEL1, CYREG_PRT0_OUT_SEL1
.set bPin__PRTDSI__SYNC_OUT, CYREG_PRT0_SYNC_OUT
.set bPin__PS, CYREG_PRT0_PS
.set bPin__SHIFT, 5
.set bPin__SLW, CYREG_PRT0_SLW

/* fineDAC */
.set fineDAC_viDAC8__CR0, CYREG_DAC3_CR0
.set fineDAC_viDAC8__CR1, CYREG_DAC3_CR1
.set fineDAC_viDAC8__D, CYREG_DAC3_D
.set fineDAC_viDAC8__PM_ACT_CFG, CYREG_PM_ACT_CFG8
.set fineDAC_viDAC8__PM_ACT_MSK, 0x08
.set fineDAC_viDAC8__PM_STBY_CFG, CYREG_PM_STBY_CFG8
.set fineDAC_viDAC8__PM_STBY_MSK, 0x08
.set fineDAC_viDAC8__STROBE, CYREG_DAC3_STROBE
.set fineDAC_viDAC8__SW0, CYREG_DAC3_SW0
.set fineDAC_viDAC8__SW2, CYREG_DAC3_SW2
.set fineDAC_viDAC8__SW3, CYREG_DAC3_SW3
.set fineDAC_viDAC8__SW4, CYREG_DAC3_SW4
.set fineDAC_viDAC8__TR, CYREG_DAC3_TR
.set fineDAC_viDAC8__TRIM__M1, CYREG_FLSHID_CUST_TABLES_DAC3_M1
.set fineDAC_viDAC8__TRIM__M2, CYREG_FLSHID_CUST_TABLES_DAC3_M2
.set fineDAC_viDAC8__TRIM__M3, CYREG_FLSHID_CUST_TABLES_DAC3_M3
.set fineDAC_viDAC8__TRIM__M4, CYREG_FLSHID_CUST_TABLES_DAC3_M4
.set fineDAC_viDAC8__TRIM__M5, CYREG_FLSHID_CUST_TABLES_DAC3_M5
.set fineDAC_viDAC8__TRIM__M6, CYREG_FLSHID_CUST_TABLES_DAC3_M6
.set fineDAC_viDAC8__TRIM__M7, CYREG_FLSHID_CUST_TABLES_DAC3_M7
.set fineDAC_viDAC8__TRIM__M8, CYREG_FLSHID_CUST_TABLES_DAC3_M8
.set fineDAC_viDAC8__TST, CYREG_DAC3_TST

/* LFOutADC */
.set LFOutADC_DEC__COHER, CYREG_DEC_COHER
.set LFOutADC_DEC__CR, CYREG_DEC_CR
.set LFOutADC_DEC__DR1, CYREG_DEC_DR1
.set LFOutADC_DEC__DR2, CYREG_DEC_DR2
.set LFOutADC_DEC__DR2H, CYREG_DEC_DR2H
.set LFOutADC_DEC__GCOR, CYREG_DEC_GCOR
.set LFOutADC_DEC__GCORH, CYREG_DEC_GCORH
.set LFOutADC_DEC__GVAL, CYREG_DEC_GVAL
.set LFOutADC_DEC__OCOR, CYREG_DEC_OCOR
.set LFOutADC_DEC__OCORH, CYREG_DEC_OCORH
.set LFOutADC_DEC__OCORM, CYREG_DEC_OCORM
.set LFOutADC_DEC__OUTSAMP, CYREG_DEC_OUTSAMP
.set LFOutADC_DEC__OUTSAMPH, CYREG_DEC_OUTSAMPH
.set LFOutADC_DEC__OUTSAMPM, CYREG_DEC_OUTSAMPM
.set LFOutADC_DEC__OUTSAMPS, CYREG_DEC_OUTSAMPS
.set LFOutADC_DEC__PM_ACT_CFG, CYREG_PM_ACT_CFG10
.set LFOutADC_DEC__PM_ACT_MSK, 0x01
.set LFOutADC_DEC__PM_STBY_CFG, CYREG_PM_STBY_CFG10
.set LFOutADC_DEC__PM_STBY_MSK, 0x01
.set LFOutADC_DEC__SHIFT1, CYREG_DEC_SHIFT1
.set LFOutADC_DEC__SHIFT2, CYREG_DEC_SHIFT2
.set LFOutADC_DEC__SR, CYREG_DEC_SR
.set LFOutADC_DEC__TRIM__M1, CYREG_FLSHID_CUST_TABLES_DEC_M1
.set LFOutADC_DEC__TRIM__M2, CYREG_FLSHID_CUST_TABLES_DEC_M2
.set LFOutADC_DEC__TRIM__M3, CYREG_FLSHID_CUST_TABLES_DEC_M3
.set LFOutADC_DEC__TRIM__M4, CYREG_FLSHID_CUST_TABLES_DEC_M4
.set LFOutADC_DEC__TRIM__M5, CYREG_FLSHID_CUST_TABLES_DEC_M5
.set LFOutADC_DEC__TRIM__M6, CYREG_FLSHID_CUST_TABLES_DEC_M6
.set LFOutADC_DEC__TRIM__M7, CYREG_FLSHID_CUST_TABLES_DEC_M7
.set LFOutADC_DEC__TRIM__M8, CYREG_FLSHID_CUST_TABLES_DEC_M8
.set LFOutADC_DSM__BUF0, CYREG_DSM0_BUF0
.set LFOutADC_DSM__BUF1, CYREG_DSM0_BUF1
.set LFOutADC_DSM__BUF2, CYREG_DSM0_BUF2
.set LFOutADC_DSM__BUF3, CYREG_DSM0_BUF3
.set LFOutADC_DSM__CLK, CYREG_DSM0_CLK
.set LFOutADC_DSM__CR0, CYREG_DSM0_CR0
.set LFOutADC_DSM__CR1, CYREG_DSM0_CR1
.set LFOutADC_DSM__CR10, CYREG_DSM0_CR10
.set LFOutADC_DSM__CR11, CYREG_DSM0_CR11
.set LFOutADC_DSM__CR12, CYREG_DSM0_CR12
.set LFOutADC_DSM__CR13, CYREG_DSM0_CR13
.set LFOutADC_DSM__CR14, CYREG_DSM0_CR14
.set LFOutADC_DSM__CR15, CYREG_DSM0_CR15
.set LFOutADC_DSM__CR16, CYREG_DSM0_CR16
.set LFOutADC_DSM__CR17, CYREG_DSM0_CR17
.set LFOutADC_DSM__CR2, CYREG_DSM0_CR2
.set LFOutADC_DSM__CR3, CYREG_DSM0_CR3
.set LFOutADC_DSM__CR4, CYREG_DSM0_CR4
.set LFOutADC_DSM__CR5, CYREG_DSM0_CR5
.set LFOutADC_DSM__CR6, CYREG_DSM0_CR6
.set LFOutADC_DSM__CR7, CYREG_DSM0_CR7
.set LFOutADC_DSM__CR8, CYREG_DSM0_CR8
.set LFOutADC_DSM__CR9, CYREG_DSM0_CR9
.set LFOutADC_DSM__DEM0, CYREG_DSM0_DEM0
.set LFOutADC_DSM__DEM1, CYREG_DSM0_DEM1
.set LFOutADC_DSM__MISC, CYREG_DSM0_MISC
.set LFOutADC_DSM__OUT0, CYREG_DSM0_OUT0
.set LFOutADC_DSM__OUT1, CYREG_DSM0_OUT1
.set LFOutADC_DSM__REF0, CYREG_DSM0_REF0
.set LFOutADC_DSM__REF1, CYREG_DSM0_REF1
.set LFOutADC_DSM__REF2, CYREG_DSM0_REF2
.set LFOutADC_DSM__REF3, CYREG_DSM0_REF3
.set LFOutADC_DSM__RSVD1, CYREG_DSM0_RSVD1
.set LFOutADC_DSM__SW0, CYREG_DSM0_SW0
.set LFOutADC_DSM__SW2, CYREG_DSM0_SW2
.set LFOutADC_DSM__SW3, CYREG_DSM0_SW3
.set LFOutADC_DSM__SW4, CYREG_DSM0_SW4
.set LFOutADC_DSM__SW6, CYREG_DSM0_SW6
.set LFOutADC_DSM__TR0, CYREG_NPUMP_DSM_TR0
.set LFOutADC_DSM__TST0, CYREG_DSM0_TST0
.set LFOutADC_DSM__TST1, CYREG_DSM0_TST1
.set LFOutADC_Ext_CP_Clk__CFG0, CYREG_CLKDIST_DCFG0_CFG0
.set LFOutADC_Ext_CP_Clk__CFG1, CYREG_CLKDIST_DCFG0_CFG1
.set LFOutADC_Ext_CP_Clk__CFG2, CYREG_CLKDIST_DCFG0_CFG2
.set LFOutADC_Ext_CP_Clk__CFG2_SRC_SEL_MASK, 0x07
.set LFOutADC_Ext_CP_Clk__INDEX, 0x00
.set LFOutADC_Ext_CP_Clk__PM_ACT_CFG, CYREG_PM_ACT_CFG2
.set LFOutADC_Ext_CP_Clk__PM_ACT_MSK, 0x01
.set LFOutADC_Ext_CP_Clk__PM_STBY_CFG, CYREG_PM_STBY_CFG2
.set LFOutADC_Ext_CP_Clk__PM_STBY_MSK, 0x01
.set LFOutADC_IRQ__INTC_CLR_EN_REG, CYREG_NVIC_CLRENA0
.set LFOutADC_IRQ__INTC_CLR_PD_REG, CYREG_NVIC_CLRPEND0
.set LFOutADC_IRQ__INTC_MASK, 0x20000000
.set LFOutADC_IRQ__INTC_NUMBER, 29
.set LFOutADC_IRQ__INTC_PRIOR_NUM, 7
.set LFOutADC_IRQ__INTC_PRIOR_REG, CYREG_NVIC_PRI_29
.set LFOutADC_IRQ__INTC_SET_EN_REG, CYREG_NVIC_SETENA0
.set LFOutADC_IRQ__INTC_SET_PD_REG, CYREG_NVIC_SETPEND0
.set LFOutADC_theACLK__CFG0, CYREG_CLKDIST_ACFG1_CFG0
.set LFOutADC_theACLK__CFG1, CYREG_CLKDIST_ACFG1_CFG1
.set LFOutADC_theACLK__CFG2, CYREG_CLKDIST_ACFG1_CFG2
.set LFOutADC_theACLK__CFG2_SRC_SEL_MASK, 0x07
.set LFOutADC_theACLK__CFG3, CYREG_CLKDIST_ACFG1_CFG3
.set LFOutADC_theACLK__CFG3_PHASE_DLY_MASK, 0x0F
.set LFOutADC_theACLK__INDEX, 0x01
.set LFOutADC_theACLK__PM_ACT_CFG, CYREG_PM_ACT_CFG1
.set LFOutADC_theACLK__PM_ACT_MSK, 0x02
.set LFOutADC_theACLK__PM_STBY_CFG, CYREG_PM_STBY_CFG1
.set LFOutADC_theACLK__PM_STBY_MSK, 0x02

/* LFOutPin */
.set LFOutPin__0__INTTYPE, CYREG_PICU0_INTTYPE1
.set LFOutPin__0__MASK, 0x02
.set LFOutPin__0__PC, CYREG_PRT0_PC1
.set LFOutPin__0__PORT, 0
.set LFOutPin__0__SHIFT, 1
.set LFOutPin__AG, CYREG_PRT0_AG
.set LFOutPin__AMUX, CYREG_PRT0_AMUX
.set LFOutPin__BIE, CYREG_PRT0_BIE
.set LFOutPin__BIT_MASK, CYREG_PRT0_BIT_MASK
.set LFOutPin__BYP, CYREG_PRT0_BYP
.set LFOutPin__CTL, CYREG_PRT0_CTL
.set LFOutPin__DM0, CYREG_PRT0_DM0
.set LFOutPin__DM1, CYREG_PRT0_DM1
.set LFOutPin__DM2, CYREG_PRT0_DM2
.set LFOutPin__DR, CYREG_PRT0_DR
.set LFOutPin__INP_DIS, CYREG_PRT0_INP_DIS
.set LFOutPin__INTTYPE_BASE, CYDEV_PICU_INTTYPE_PICU0_BASE
.set LFOutPin__LCD_COM_SEG, CYREG_PRT0_LCD_COM_SEG
.set LFOutPin__LCD_EN, CYREG_PRT0_LCD_EN
.set LFOutPin__MASK, 0x02
.set LFOutPin__PORT, 0
.set LFOutPin__PRT, CYREG_PRT0_PRT
.set LFOutPin__PRTDSI__CAPS_SEL, CYREG_PRT0_CAPS_SEL
.set LFOutPin__PRTDSI__DBL_SYNC_IN, CYREG_PRT0_DBL_SYNC_IN
.set LFOutPin__PRTDSI__OE_SEL0, CYREG_PRT0_OE_SEL0
.set LFOutPin__PRTDSI__OE_SEL1, CYREG_PRT0_OE_SEL1
.set LFOutPin__PRTDSI__OUT_SEL0, CYREG_PRT0_OUT_SEL0
.set LFOutPin__PRTDSI__OUT_SEL1, CYREG_PRT0_OUT_SEL1
.set LFOutPin__PRTDSI__SYNC_OUT, CYREG_PRT0_SYNC_OUT
.set LFOutPin__PS, CYREG_PRT0_PS
.set LFOutPin__SHIFT, 1
.set LFOutPin__SLW, CYREG_PRT0_SLW

/* redLight */
.set redLight__0__INTTYPE, CYREG_PICU5_INTTYPE1
.set redLight__0__MASK, 0x02
.set redLight__0__PC, CYREG_PRT5_PC1
.set redLight__0__PORT, 5
.set redLight__0__SHIFT, 1
.set redLight__AG, CYREG_PRT5_AG
.set redLight__AMUX, CYREG_PRT5_AMUX
.set redLight__BIE, CYREG_PRT5_BIE
.set redLight__BIT_MASK, CYREG_PRT5_BIT_MASK
.set redLight__BYP, CYREG_PRT5_BYP
.set redLight__CTL, CYREG_PRT5_CTL
.set redLight__DM0, CYREG_PRT5_DM0
.set redLight__DM1, CYREG_PRT5_DM1
.set redLight__DM2, CYREG_PRT5_DM2
.set redLight__DR, CYREG_PRT5_DR
.set redLight__INP_DIS, CYREG_PRT5_INP_DIS
.set redLight__INTTYPE_BASE, CYDEV_PICU_INTTYPE_PICU5_BASE
.set redLight__LCD_COM_SEG, CYREG_PRT5_LCD_COM_SEG
.set redLight__LCD_EN, CYREG_PRT5_LCD_EN
.set redLight__MASK, 0x02
.set redLight__PORT, 5
.set redLight__PRT, CYREG_PRT5_PRT
.set redLight__PRTDSI__CAPS_SEL, CYREG_PRT5_CAPS_SEL
.set redLight__PRTDSI__DBL_SYNC_IN, CYREG_PRT5_DBL_SYNC_IN
.set redLight__PRTDSI__OE_SEL0, CYREG_PRT5_OE_SEL0
.set redLight__PRTDSI__OE_SEL1, CYREG_PRT5_OE_SEL1
.set redLight__PRTDSI__OUT_SEL0, CYREG_PRT5_OUT_SEL0
.set redLight__PRTDSI__OUT_SEL1, CYREG_PRT5_OUT_SEL1
.set redLight__PRTDSI__SYNC_OUT, CYREG_PRT5_SYNC_OUT
.set redLight__PS, CYREG_PRT5_PS
.set redLight__SHIFT, 1
.set redLight__SLW, CYREG_PRT5_SLW

/* switches */
.set switches_Sync_ctrl_reg__0__MASK, 0x01
.set switches_Sync_ctrl_reg__0__POS, 0
.set switches_Sync_ctrl_reg__16BIT_CONTROL_AUX_CTL_REG, CYREG_B0_UDB02_03_ACTL
.set switches_Sync_ctrl_reg__16BIT_CONTROL_CONTROL_REG, CYREG_B0_UDB02_03_CTL
.set switches_Sync_ctrl_reg__16BIT_CONTROL_COUNT_REG, CYREG_B0_UDB02_03_CTL
.set switches_Sync_ctrl_reg__16BIT_COUNT_CONTROL_REG, CYREG_B0_UDB02_03_CTL
.set switches_Sync_ctrl_reg__16BIT_COUNT_COUNT_REG, CYREG_B0_UDB02_03_CTL
.set switches_Sync_ctrl_reg__16BIT_MASK_MASK_REG, CYREG_B0_UDB02_03_MSK
.set switches_Sync_ctrl_reg__16BIT_MASK_PERIOD_REG, CYREG_B0_UDB02_03_MSK
.set switches_Sync_ctrl_reg__16BIT_PERIOD_MASK_REG, CYREG_B0_UDB02_03_MSK
.set switches_Sync_ctrl_reg__16BIT_PERIOD_PERIOD_REG, CYREG_B0_UDB02_03_MSK
.set switches_Sync_ctrl_reg__CONTROL_AUX_CTL_REG, CYREG_B0_UDB02_ACTL
.set switches_Sync_ctrl_reg__CONTROL_REG, CYREG_B0_UDB02_CTL
.set switches_Sync_ctrl_reg__CONTROL_ST_REG, CYREG_B0_UDB02_ST_CTL
.set switches_Sync_ctrl_reg__COUNT_REG, CYREG_B0_UDB02_CTL
.set switches_Sync_ctrl_reg__COUNT_ST_REG, CYREG_B0_UDB02_ST_CTL
.set switches_Sync_ctrl_reg__MASK, 0x01
.set switches_Sync_ctrl_reg__MASK_CTL_AUX_CTL_REG, CYREG_B0_UDB02_MSK_ACTL
.set switches_Sync_ctrl_reg__PER_CTL_AUX_CTL_REG, CYREG_B0_UDB02_MSK_ACTL
.set switches_Sync_ctrl_reg__PERIOD_REG, CYREG_B0_UDB02_MSK

/* coarseDAC */
.set coarseDAC_viDAC8__CR0, CYREG_DAC0_CR0
.set coarseDAC_viDAC8__CR1, CYREG_DAC0_CR1
.set coarseDAC_viDAC8__D, CYREG_DAC0_D
.set coarseDAC_viDAC8__PM_ACT_CFG, CYREG_PM_ACT_CFG8
.set coarseDAC_viDAC8__PM_ACT_MSK, 0x01
.set coarseDAC_viDAC8__PM_STBY_CFG, CYREG_PM_STBY_CFG8
.set coarseDAC_viDAC8__PM_STBY_MSK, 0x01
.set coarseDAC_viDAC8__STROBE, CYREG_DAC0_STROBE
.set coarseDAC_viDAC8__SW0, CYREG_DAC0_SW0
.set coarseDAC_viDAC8__SW2, CYREG_DAC0_SW2
.set coarseDAC_viDAC8__SW3, CYREG_DAC0_SW3
.set coarseDAC_viDAC8__SW4, CYREG_DAC0_SW4
.set coarseDAC_viDAC8__TR, CYREG_DAC0_TR
.set coarseDAC_viDAC8__TRIM__M1, CYREG_FLSHID_CUST_TABLES_DAC0_M1
.set coarseDAC_viDAC8__TRIM__M2, CYREG_FLSHID_CUST_TABLES_DAC0_M2
.set coarseDAC_viDAC8__TRIM__M3, CYREG_FLSHID_CUST_TABLES_DAC0_M3
.set coarseDAC_viDAC8__TRIM__M4, CYREG_FLSHID_CUST_TABLES_DAC0_M4
.set coarseDAC_viDAC8__TRIM__M5, CYREG_FLSHID_CUST_TABLES_DAC0_M5
.set coarseDAC_viDAC8__TRIM__M6, CYREG_FLSHID_CUST_TABLES_DAC0_M6
.set coarseDAC_viDAC8__TRIM__M7, CYREG_FLSHID_CUST_TABLES_DAC0_M7
.set coarseDAC_viDAC8__TRIM__M8, CYREG_FLSHID_CUST_TABLES_DAC0_M8
.set coarseDAC_viDAC8__TST, CYREG_DAC0_TST

/* errMonADC */
.set errMonADC_ADC_SAR__CLK, CYREG_SAR0_CLK
.set errMonADC_ADC_SAR__CSR0, CYREG_SAR0_CSR0
.set errMonADC_ADC_SAR__CSR1, CYREG_SAR0_CSR1
.set errMonADC_ADC_SAR__CSR2, CYREG_SAR0_CSR2
.set errMonADC_ADC_SAR__CSR3, CYREG_SAR0_CSR3
.set errMonADC_ADC_SAR__CSR4, CYREG_SAR0_CSR4
.set errMonADC_ADC_SAR__CSR5, CYREG_SAR0_CSR5
.set errMonADC_ADC_SAR__CSR6, CYREG_SAR0_CSR6
.set errMonADC_ADC_SAR__PM_ACT_CFG, CYREG_PM_ACT_CFG11
.set errMonADC_ADC_SAR__PM_ACT_MSK, 0x01
.set errMonADC_ADC_SAR__PM_STBY_CFG, CYREG_PM_STBY_CFG11
.set errMonADC_ADC_SAR__PM_STBY_MSK, 0x01
.set errMonADC_ADC_SAR__SW0, CYREG_SAR0_SW0
.set errMonADC_ADC_SAR__SW2, CYREG_SAR0_SW2
.set errMonADC_ADC_SAR__SW3, CYREG_SAR0_SW3
.set errMonADC_ADC_SAR__SW4, CYREG_SAR0_SW4
.set errMonADC_ADC_SAR__SW6, CYREG_SAR0_SW6
.set errMonADC_ADC_SAR__TR0, CYREG_SAR0_TR0
.set errMonADC_ADC_SAR__WRK0, CYREG_SAR0_WRK0
.set errMonADC_ADC_SAR__WRK1, CYREG_SAR0_WRK1
.set errMonADC_IRQ__INTC_CLR_EN_REG, CYREG_NVIC_CLRENA0
.set errMonADC_IRQ__INTC_CLR_PD_REG, CYREG_NVIC_CLRPEND0
.set errMonADC_IRQ__INTC_MASK, 0x01
.set errMonADC_IRQ__INTC_NUMBER, 0
.set errMonADC_IRQ__INTC_PRIOR_NUM, 7
.set errMonADC_IRQ__INTC_PRIOR_REG, CYREG_NVIC_PRI_0
.set errMonADC_IRQ__INTC_SET_EN_REG, CYREG_NVIC_SETENA0
.set errMonADC_IRQ__INTC_SET_PD_REG, CYREG_NVIC_SETPEND0
.set errMonADC_theACLK__CFG0, CYREG_CLKDIST_ACFG0_CFG0
.set errMonADC_theACLK__CFG1, CYREG_CLKDIST_ACFG0_CFG1
.set errMonADC_theACLK__CFG2, CYREG_CLKDIST_ACFG0_CFG2
.set errMonADC_theACLK__CFG2_SRC_SEL_MASK, 0x07
.set errMonADC_theACLK__CFG3, CYREG_CLKDIST_ACFG0_CFG3
.set errMonADC_theACLK__CFG3_PHASE_DLY_MASK, 0x0F
.set errMonADC_theACLK__INDEX, 0x00
.set errMonADC_theACLK__PM_ACT_CFG, CYREG_PM_ACT_CFG1
.set errMonADC_theACLK__PM_ACT_MSK, 0x01
.set errMonADC_theACLK__PM_STBY_CFG, CYREG_PM_STBY_CFG1
.set errMonADC_theACLK__PM_STBY_MSK, 0x01

/* errMonPin */
.set errMonPin__0__INTTYPE, CYREG_PICU0_INTTYPE3
.set errMonPin__0__MASK, 0x08
.set errMonPin__0__PC, CYREG_PRT0_PC3
.set errMonPin__0__PORT, 0
.set errMonPin__0__SHIFT, 3
.set errMonPin__AG, CYREG_PRT0_AG
.set errMonPin__AMUX, CYREG_PRT0_AMUX
.set errMonPin__BIE, CYREG_PRT0_BIE
.set errMonPin__BIT_MASK, CYREG_PRT0_BIT_MASK
.set errMonPin__BYP, CYREG_PRT0_BYP
.set errMonPin__CTL, CYREG_PRT0_CTL
.set errMonPin__DM0, CYREG_PRT0_DM0
.set errMonPin__DM1, CYREG_PRT0_DM1
.set errMonPin__DM2, CYREG_PRT0_DM2
.set errMonPin__DR, CYREG_PRT0_DR
.set errMonPin__INP_DIS, CYREG_PRT0_INP_DIS
.set errMonPin__INTTYPE_BASE, CYDEV_PICU_INTTYPE_PICU0_BASE
.set errMonPin__LCD_COM_SEG, CYREG_PRT0_LCD_COM_SEG
.set errMonPin__LCD_EN, CYREG_PRT0_LCD_EN
.set errMonPin__MASK, 0x08
.set errMonPin__PORT, 0
.set errMonPin__PRT, CYREG_PRT0_PRT
.set errMonPin__PRTDSI__CAPS_SEL, CYREG_PRT0_CAPS_SEL
.set errMonPin__PRTDSI__DBL_SYNC_IN, CYREG_PRT0_DBL_SYNC_IN
.set errMonPin__PRTDSI__OE_SEL0, CYREG_PRT0_OE_SEL0
.set errMonPin__PRTDSI__OE_SEL1, CYREG_PRT0_OE_SEL1
.set errMonPin__PRTDSI__OUT_SEL0, CYREG_PRT0_OUT_SEL0
.set errMonPin__PRTDSI__OUT_SEL1, CYREG_PRT0_OUT_SEL1
.set errMonPin__PRTDSI__SYNC_OUT, CYREG_PRT0_SYNC_OUT
.set errMonPin__PS, CYREG_PRT0_PS
.set errMonPin__SHIFT, 3
.set errMonPin__SLW, CYREG_PRT0_SLW

/* setting8V */
.set setting8V__0__INTTYPE, CYREG_PICU0_INTTYPE4
.set setting8V__0__MASK, 0x10
.set setting8V__0__PC, CYREG_PRT0_PC4
.set setting8V__0__PORT, 0
.set setting8V__0__SHIFT, 4
.set setting8V__AG, CYREG_PRT0_AG
.set setting8V__AMUX, CYREG_PRT0_AMUX
.set setting8V__BIE, CYREG_PRT0_BIE
.set setting8V__BIT_MASK, CYREG_PRT0_BIT_MASK
.set setting8V__BYP, CYREG_PRT0_BYP
.set setting8V__CTL, CYREG_PRT0_CTL
.set setting8V__DM0, CYREG_PRT0_DM0
.set setting8V__DM1, CYREG_PRT0_DM1
.set setting8V__DM2, CYREG_PRT0_DM2
.set setting8V__DR, CYREG_PRT0_DR
.set setting8V__INP_DIS, CYREG_PRT0_INP_DIS
.set setting8V__INTTYPE_BASE, CYDEV_PICU_INTTYPE_PICU0_BASE
.set setting8V__LCD_COM_SEG, CYREG_PRT0_LCD_COM_SEG
.set setting8V__LCD_EN, CYREG_PRT0_LCD_EN
.set setting8V__MASK, 0x10
.set setting8V__PORT, 0
.set setting8V__PRT, CYREG_PRT0_PRT
.set setting8V__PRTDSI__CAPS_SEL, CYREG_PRT0_CAPS_SEL
.set setting8V__PRTDSI__DBL_SYNC_IN, CYREG_PRT0_DBL_SYNC_IN
.set setting8V__PRTDSI__OE_SEL0, CYREG_PRT0_OE_SEL0
.set setting8V__PRTDSI__OE_SEL1, CYREG_PRT0_OE_SEL1
.set setting8V__PRTDSI__OUT_SEL0, CYREG_PRT0_OUT_SEL0
.set setting8V__PRTDSI__OUT_SEL1, CYREG_PRT0_OUT_SEL1
.set setting8V__PRTDSI__SYNC_OUT, CYREG_PRT0_SYNC_OUT
.set setting8V__PS, CYREG_PRT0_PS
.set setting8V__SHIFT, 4
.set setting8V__SLW, CYREG_PRT0_SLW

/* fineDACOut */
.set fineDACOut__0__INTTYPE, CYREG_PICU3_INTTYPE1
.set fineDACOut__0__MASK, 0x02
.set fineDACOut__0__PC, CYREG_PRT3_PC1
.set fineDACOut__0__PORT, 3
.set fineDACOut__0__SHIFT, 1
.set fineDACOut__AG, CYREG_PRT3_AG
.set fineDACOut__AMUX, CYREG_PRT3_AMUX
.set fineDACOut__BIE, CYREG_PRT3_BIE
.set fineDACOut__BIT_MASK, CYREG_PRT3_BIT_MASK
.set fineDACOut__BYP, CYREG_PRT3_BYP
.set fineDACOut__CTL, CYREG_PRT3_CTL
.set fineDACOut__DM0, CYREG_PRT3_DM0
.set fineDACOut__DM1, CYREG_PRT3_DM1
.set fineDACOut__DM2, CYREG_PRT3_DM2
.set fineDACOut__DR, CYREG_PRT3_DR
.set fineDACOut__INP_DIS, CYREG_PRT3_INP_DIS
.set fineDACOut__INTTYPE_BASE, CYDEV_PICU_INTTYPE_PICU3_BASE
.set fineDACOut__LCD_COM_SEG, CYREG_PRT3_LCD_COM_SEG
.set fineDACOut__LCD_EN, CYREG_PRT3_LCD_EN
.set fineDACOut__MASK, 0x02
.set fineDACOut__PORT, 3
.set fineDACOut__PRT, CYREG_PRT3_PRT
.set fineDACOut__PRTDSI__CAPS_SEL, CYREG_PRT3_CAPS_SEL
.set fineDACOut__PRTDSI__DBL_SYNC_IN, CYREG_PRT3_DBL_SYNC_IN
.set fineDACOut__PRTDSI__OE_SEL0, CYREG_PRT3_OE_SEL0
.set fineDACOut__PRTDSI__OE_SEL1, CYREG_PRT3_OE_SEL1
.set fineDACOut__PRTDSI__OUT_SEL0, CYREG_PRT3_OUT_SEL0
.set fineDACOut__PRTDSI__OUT_SEL1, CYREG_PRT3_OUT_SEL1
.set fineDACOut__PRTDSI__SYNC_OUT, CYREG_PRT3_SYNC_OUT
.set fineDACOut__PS, CYREG_PRT3_PS
.set fineDACOut__SHIFT, 1
.set fineDACOut__SLW, CYREG_PRT3_SLW

/* greenLight */
.set greenLight__0__INTTYPE, CYREG_PICU5_INTTYPE7
.set greenLight__0__MASK, 0x80
.set greenLight__0__PC, CYREG_PRT5_PC7
.set greenLight__0__PORT, 5
.set greenLight__0__SHIFT, 7
.set greenLight__AG, CYREG_PRT5_AG
.set greenLight__AMUX, CYREG_PRT5_AMUX
.set greenLight__BIE, CYREG_PRT5_BIE
.set greenLight__BIT_MASK, CYREG_PRT5_BIT_MASK
.set greenLight__BYP, CYREG_PRT5_BYP
.set greenLight__CTL, CYREG_PRT5_CTL
.set greenLight__DM0, CYREG_PRT5_DM0
.set greenLight__DM1, CYREG_PRT5_DM1
.set greenLight__DM2, CYREG_PRT5_DM2
.set greenLight__DR, CYREG_PRT5_DR
.set greenLight__INP_DIS, CYREG_PRT5_INP_DIS
.set greenLight__INTTYPE_BASE, CYDEV_PICU_INTTYPE_PICU5_BASE
.set greenLight__LCD_COM_SEG, CYREG_PRT5_LCD_COM_SEG
.set greenLight__LCD_EN, CYREG_PRT5_LCD_EN
.set greenLight__MASK, 0x80
.set greenLight__PORT, 5
.set greenLight__PRT, CYREG_PRT5_PRT
.set greenLight__PRTDSI__CAPS_SEL, CYREG_PRT5_CAPS_SEL
.set greenLight__PRTDSI__DBL_SYNC_IN, CYREG_PRT5_DBL_SYNC_IN
.set greenLight__PRTDSI__OE_SEL0, CYREG_PRT5_OE_SEL0
.set greenLight__PRTDSI__OE_SEL1, CYREG_PRT5_OE_SEL1
.set greenLight__PRTDSI__OUT_SEL0, CYREG_PRT5_OUT_SEL0
.set greenLight__PRTDSI__OUT_SEL1, CYREG_PRT5_OUT_SEL1
.set greenLight__PRTDSI__SYNC_OUT, CYREG_PRT5_SYNC_OUT
.set greenLight__PS, CYREG_PRT5_PS
.set greenLight__SHIFT, 7
.set greenLight__SLW, CYREG_PRT5_SLW

/* setting22V */
.set setting22V__0__INTTYPE, CYREG_PICU0_INTTYPE2
.set setting22V__0__MASK, 0x04
.set setting22V__0__PC, CYREG_PRT0_PC2
.set setting22V__0__PORT, 0
.set setting22V__0__SHIFT, 2
.set setting22V__AG, CYREG_PRT0_AG
.set setting22V__AMUX, CYREG_PRT0_AMUX
.set setting22V__BIE, CYREG_PRT0_BIE
.set setting22V__BIT_MASK, CYREG_PRT0_BIT_MASK
.set setting22V__BYP, CYREG_PRT0_BYP
.set setting22V__CTL, CYREG_PRT0_CTL
.set setting22V__DM0, CYREG_PRT0_DM0
.set setting22V__DM1, CYREG_PRT0_DM1
.set setting22V__DM2, CYREG_PRT0_DM2
.set setting22V__DR, CYREG_PRT0_DR
.set setting22V__INP_DIS, CYREG_PRT0_INP_DIS
.set setting22V__INTTYPE_BASE, CYDEV_PICU_INTTYPE_PICU0_BASE
.set setting22V__LCD_COM_SEG, CYREG_PRT0_LCD_COM_SEG
.set setting22V__LCD_EN, CYREG_PRT0_LCD_EN
.set setting22V__MASK, 0x04
.set setting22V__PORT, 0
.set setting22V__PRT, CYREG_PRT0_PRT
.set setting22V__PRTDSI__CAPS_SEL, CYREG_PRT0_CAPS_SEL
.set setting22V__PRTDSI__DBL_SYNC_IN, CYREG_PRT0_DBL_SYNC_IN
.set setting22V__PRTDSI__OE_SEL0, CYREG_PRT0_OE_SEL0
.set setting22V__PRTDSI__OE_SEL1, CYREG_PRT0_OE_SEL1
.set setting22V__PRTDSI__OUT_SEL0, CYREG_PRT0_OUT_SEL0
.set setting22V__PRTDSI__OUT_SEL1, CYREG_PRT0_OUT_SEL1
.set setting22V__PRTDSI__SYNC_OUT, CYREG_PRT0_SYNC_OUT
.set setting22V__PS, CYREG_PRT0_PS
.set setting22V__SHIFT, 2
.set setting22V__SLW, CYREG_PRT0_SLW

/* setting28V */
.set setting28V__0__INTTYPE, CYREG_PICU0_INTTYPE0
.set setting28V__0__MASK, 0x01
.set setting28V__0__PC, CYREG_PRT0_PC0
.set setting28V__0__PORT, 0
.set setting28V__0__SHIFT, 0
.set setting28V__AG, CYREG_PRT0_AG
.set setting28V__AMUX, CYREG_PRT0_AMUX
.set setting28V__BIE, CYREG_PRT0_BIE
.set setting28V__BIT_MASK, CYREG_PRT0_BIT_MASK
.set setting28V__BYP, CYREG_PRT0_BYP
.set setting28V__CTL, CYREG_PRT0_CTL
.set setting28V__DM0, CYREG_PRT0_DM0
.set setting28V__DM1, CYREG_PRT0_DM1
.set setting28V__DM2, CYREG_PRT0_DM2
.set setting28V__DR, CYREG_PRT0_DR
.set setting28V__INP_DIS, CYREG_PRT0_INP_DIS
.set setting28V__INTTYPE_BASE, CYDEV_PICU_INTTYPE_PICU0_BASE
.set setting28V__LCD_COM_SEG, CYREG_PRT0_LCD_COM_SEG
.set setting28V__LCD_EN, CYREG_PRT0_LCD_EN
.set setting28V__MASK, 0x01
.set setting28V__PORT, 0
.set setting28V__PRT, CYREG_PRT0_PRT
.set setting28V__PRTDSI__CAPS_SEL, CYREG_PRT0_CAPS_SEL
.set setting28V__PRTDSI__DBL_SYNC_IN, CYREG_PRT0_DBL_SYNC_IN
.set setting28V__PRTDSI__OE_SEL0, CYREG_PRT0_OE_SEL0
.set setting28V__PRTDSI__OE_SEL1, CYREG_PRT0_OE_SEL1
.set setting28V__PRTDSI__OUT_SEL0, CYREG_PRT0_OUT_SEL0
.set setting28V__PRTDSI__OUT_SEL1, CYREG_PRT0_OUT_SEL1
.set setting28V__PRTDSI__SYNC_OUT, CYREG_PRT0_SYNC_OUT
.set setting28V__PS, CYREG_PRT0_PS
.set setting28V__SHIFT, 0
.set setting28V__SLW, CYREG_PRT0_SLW

/* orangeLight */
.set orangeLight__0__INTTYPE, CYREG_PICU5_INTTYPE3
.set orangeLight__0__MASK, 0x08
.set orangeLight__0__PC, CYREG_PRT5_PC3
.set orangeLight__0__PORT, 5
.set orangeLight__0__SHIFT, 3
.set orangeLight__AG, CYREG_PRT5_AG
.set orangeLight__AMUX, CYREG_PRT5_AMUX
.set orangeLight__BIE, CYREG_PRT5_BIE
.set orangeLight__BIT_MASK, CYREG_PRT5_BIT_MASK
.set orangeLight__BYP, CYREG_PRT5_BYP
.set orangeLight__CTL, CYREG_PRT5_CTL
.set orangeLight__DM0, CYREG_PRT5_DM0
.set orangeLight__DM1, CYREG_PRT5_DM1
.set orangeLight__DM2, CYREG_PRT5_DM2
.set orangeLight__DR, CYREG_PRT5_DR
.set orangeLight__INP_DIS, CYREG_PRT5_INP_DIS
.set orangeLight__INTTYPE_BASE, CYDEV_PICU_INTTYPE_PICU5_BASE
.set orangeLight__LCD_COM_SEG, CYREG_PRT5_LCD_COM_SEG
.set orangeLight__LCD_EN, CYREG_PRT5_LCD_EN
.set orangeLight__MASK, 0x08
.set orangeLight__PORT, 5
.set orangeLight__PRT, CYREG_PRT5_PRT
.set orangeLight__PRTDSI__CAPS_SEL, CYREG_PRT5_CAPS_SEL
.set orangeLight__PRTDSI__DBL_SYNC_IN, CYREG_PRT5_DBL_SYNC_IN
.set orangeLight__PRTDSI__OE_SEL0, CYREG_PRT5_OE_SEL0
.set orangeLight__PRTDSI__OE_SEL1, CYREG_PRT5_OE_SEL1
.set orangeLight__PRTDSI__OUT_SEL0, CYREG_PRT5_OUT_SEL0
.set orangeLight__PRTDSI__OUT_SEL1, CYREG_PRT5_OUT_SEL1
.set orangeLight__PRTDSI__SYNC_OUT, CYREG_PRT5_SYNC_OUT
.set orangeLight__PS, CYREG_PRT5_PS
.set orangeLight__SHIFT, 3
.set orangeLight__SLW, CYREG_PRT5_SLW

/* tempTrigger */
.set tempTrigger__0__INTTYPE, CYREG_PICU5_INTTYPE0
.set tempTrigger__0__MASK, 0x01
.set tempTrigger__0__PC, CYREG_PRT5_PC0
.set tempTrigger__0__PORT, 5
.set tempTrigger__0__SHIFT, 0
.set tempTrigger__AG, CYREG_PRT5_AG
.set tempTrigger__AMUX, CYREG_PRT5_AMUX
.set tempTrigger__BIE, CYREG_PRT5_BIE
.set tempTrigger__BIT_MASK, CYREG_PRT5_BIT_MASK
.set tempTrigger__BYP, CYREG_PRT5_BYP
.set tempTrigger__CTL, CYREG_PRT5_CTL
.set tempTrigger__DM0, CYREG_PRT5_DM0
.set tempTrigger__DM1, CYREG_PRT5_DM1
.set tempTrigger__DM2, CYREG_PRT5_DM2
.set tempTrigger__DR, CYREG_PRT5_DR
.set tempTrigger__INP_DIS, CYREG_PRT5_INP_DIS
.set tempTrigger__INTTYPE_BASE, CYDEV_PICU_INTTYPE_PICU5_BASE
.set tempTrigger__LCD_COM_SEG, CYREG_PRT5_LCD_COM_SEG
.set tempTrigger__LCD_EN, CYREG_PRT5_LCD_EN
.set tempTrigger__MASK, 0x01
.set tempTrigger__PORT, 5
.set tempTrigger__PRT, CYREG_PRT5_PRT
.set tempTrigger__PRTDSI__CAPS_SEL, CYREG_PRT5_CAPS_SEL
.set tempTrigger__PRTDSI__DBL_SYNC_IN, CYREG_PRT5_DBL_SYNC_IN
.set tempTrigger__PRTDSI__OE_SEL0, CYREG_PRT5_OE_SEL0
.set tempTrigger__PRTDSI__OE_SEL1, CYREG_PRT5_OE_SEL1
.set tempTrigger__PRTDSI__OUT_SEL0, CYREG_PRT5_OUT_SEL0
.set tempTrigger__PRTDSI__OUT_SEL1, CYREG_PRT5_OUT_SEL1
.set tempTrigger__PRTDSI__SYNC_OUT, CYREG_PRT5_SYNC_OUT
.set tempTrigger__PS, CYREG_PRT5_PS
.set tempTrigger__SHIFT, 0
.set tempTrigger__SLW, CYREG_PRT5_SLW

/* yellowLight */
.set yellowLight__0__INTTYPE, CYREG_PICU5_INTTYPE5
.set yellowLight__0__MASK, 0x20
.set yellowLight__0__PC, CYREG_PRT5_PC5
.set yellowLight__0__PORT, 5
.set yellowLight__0__SHIFT, 5
.set yellowLight__AG, CYREG_PRT5_AG
.set yellowLight__AMUX, CYREG_PRT5_AMUX
.set yellowLight__BIE, CYREG_PRT5_BIE
.set yellowLight__BIT_MASK, CYREG_PRT5_BIT_MASK
.set yellowLight__BYP, CYREG_PRT5_BYP
.set yellowLight__CTL, CYREG_PRT5_CTL
.set yellowLight__DM0, CYREG_PRT5_DM0
.set yellowLight__DM1, CYREG_PRT5_DM1
.set yellowLight__DM2, CYREG_PRT5_DM2
.set yellowLight__DR, CYREG_PRT5_DR
.set yellowLight__INP_DIS, CYREG_PRT5_INP_DIS
.set yellowLight__INTTYPE_BASE, CYDEV_PICU_INTTYPE_PICU5_BASE
.set yellowLight__LCD_COM_SEG, CYREG_PRT5_LCD_COM_SEG
.set yellowLight__LCD_EN, CYREG_PRT5_LCD_EN
.set yellowLight__MASK, 0x20
.set yellowLight__PORT, 5
.set yellowLight__PRT, CYREG_PRT5_PRT
.set yellowLight__PRTDSI__CAPS_SEL, CYREG_PRT5_CAPS_SEL
.set yellowLight__PRTDSI__DBL_SYNC_IN, CYREG_PRT5_DBL_SYNC_IN
.set yellowLight__PRTDSI__OE_SEL0, CYREG_PRT5_OE_SEL0
.set yellowLight__PRTDSI__OE_SEL1, CYREG_PRT5_OE_SEL1
.set yellowLight__PRTDSI__OUT_SEL0, CYREG_PRT5_OUT_SEL0
.set yellowLight__PRTDSI__OUT_SEL1, CYREG_PRT5_OUT_SEL1
.set yellowLight__PRTDSI__SYNC_OUT, CYREG_PRT5_SYNC_OUT
.set yellowLight__PS, CYREG_PRT5_PS
.set yellowLight__SHIFT, 5
.set yellowLight__SLW, CYREG_PRT5_SLW

/* SW_Tx_UART_1 */
.set SW_Tx_UART_1_tx__0__INTTYPE, CYREG_PICU2_INTTYPE1
.set SW_Tx_UART_1_tx__0__MASK, 0x02
.set SW_Tx_UART_1_tx__0__PC, CYREG_PRT2_PC1
.set SW_Tx_UART_1_tx__0__PORT, 2
.set SW_Tx_UART_1_tx__0__SHIFT, 1
.set SW_Tx_UART_1_tx__AG, CYREG_PRT2_AG
.set SW_Tx_UART_1_tx__AMUX, CYREG_PRT2_AMUX
.set SW_Tx_UART_1_tx__BIE, CYREG_PRT2_BIE
.set SW_Tx_UART_1_tx__BIT_MASK, CYREG_PRT2_BIT_MASK
.set SW_Tx_UART_1_tx__BYP, CYREG_PRT2_BYP
.set SW_Tx_UART_1_tx__CTL, CYREG_PRT2_CTL
.set SW_Tx_UART_1_tx__DM0, CYREG_PRT2_DM0
.set SW_Tx_UART_1_tx__DM1, CYREG_PRT2_DM1
.set SW_Tx_UART_1_tx__DM2, CYREG_PRT2_DM2
.set SW_Tx_UART_1_tx__DR, CYREG_PRT2_DR
.set SW_Tx_UART_1_tx__INP_DIS, CYREG_PRT2_INP_DIS
.set SW_Tx_UART_1_tx__INTTYPE_BASE, CYDEV_PICU_INTTYPE_PICU2_BASE
.set SW_Tx_UART_1_tx__LCD_COM_SEG, CYREG_PRT2_LCD_COM_SEG
.set SW_Tx_UART_1_tx__LCD_EN, CYREG_PRT2_LCD_EN
.set SW_Tx_UART_1_tx__MASK, 0x02
.set SW_Tx_UART_1_tx__PORT, 2
.set SW_Tx_UART_1_tx__PRT, CYREG_PRT2_PRT
.set SW_Tx_UART_1_tx__PRTDSI__CAPS_SEL, CYREG_PRT2_CAPS_SEL
.set SW_Tx_UART_1_tx__PRTDSI__DBL_SYNC_IN, CYREG_PRT2_DBL_SYNC_IN
.set SW_Tx_UART_1_tx__PRTDSI__OE_SEL0, CYREG_PRT2_OE_SEL0
.set SW_Tx_UART_1_tx__PRTDSI__OE_SEL1, CYREG_PRT2_OE_SEL1
.set SW_Tx_UART_1_tx__PRTDSI__OUT_SEL0, CYREG_PRT2_OUT_SEL0
.set SW_Tx_UART_1_tx__PRTDSI__OUT_SEL1, CYREG_PRT2_OUT_SEL1
.set SW_Tx_UART_1_tx__PRTDSI__SYNC_OUT, CYREG_PRT2_SYNC_OUT
.set SW_Tx_UART_1_tx__PS, CYREG_PRT2_PS
.set SW_Tx_UART_1_tx__SHIFT, 1
.set SW_Tx_UART_1_tx__SLW, CYREG_PRT2_SLW

/* blockLockPin */
.set blockLockPin__0__INTTYPE, CYREG_PICU3_INTTYPE0
.set blockLockPin__0__MASK, 0x01
.set blockLockPin__0__PC, CYREG_PRT3_PC0
.set blockLockPin__0__PORT, 3
.set blockLockPin__0__SHIFT, 0
.set blockLockPin__AG, CYREG_PRT3_AG
.set blockLockPin__AMUX, CYREG_PRT3_AMUX
.set blockLockPin__BIE, CYREG_PRT3_BIE
.set blockLockPin__BIT_MASK, CYREG_PRT3_BIT_MASK
.set blockLockPin__BYP, CYREG_PRT3_BYP
.set blockLockPin__CTL, CYREG_PRT3_CTL
.set blockLockPin__DM0, CYREG_PRT3_DM0
.set blockLockPin__DM1, CYREG_PRT3_DM1
.set blockLockPin__DM2, CYREG_PRT3_DM2
.set blockLockPin__DR, CYREG_PRT3_DR
.set blockLockPin__INP_DIS, CYREG_PRT3_INP_DIS
.set blockLockPin__INTTYPE_BASE, CYDEV_PICU_INTTYPE_PICU3_BASE
.set blockLockPin__LCD_COM_SEG, CYREG_PRT3_LCD_COM_SEG
.set blockLockPin__LCD_EN, CYREG_PRT3_LCD_EN
.set blockLockPin__MASK, 0x01
.set blockLockPin__PORT, 3
.set blockLockPin__PRT, CYREG_PRT3_PRT
.set blockLockPin__PRTDSI__CAPS_SEL, CYREG_PRT3_CAPS_SEL
.set blockLockPin__PRTDSI__DBL_SYNC_IN, CYREG_PRT3_DBL_SYNC_IN
.set blockLockPin__PRTDSI__OE_SEL0, CYREG_PRT3_OE_SEL0
.set blockLockPin__PRTDSI__OE_SEL1, CYREG_PRT3_OE_SEL1
.set blockLockPin__PRTDSI__OUT_SEL0, CYREG_PRT3_OUT_SEL0
.set blockLockPin__PRTDSI__OUT_SEL1, CYREG_PRT3_OUT_SEL1
.set blockLockPin__PRTDSI__SYNC_OUT, CYREG_PRT3_SYNC_OUT
.set blockLockPin__PS, CYREG_PRT3_PS
.set blockLockPin__SHIFT, 0
.set blockLockPin__SLW, CYREG_PRT3_SLW

/* calibratePin */
.set calibratePin__0__INTTYPE, CYREG_PICU5_INTTYPE2
.set calibratePin__0__MASK, 0x04
.set calibratePin__0__PC, CYREG_PRT5_PC2
.set calibratePin__0__PORT, 5
.set calibratePin__0__SHIFT, 2
.set calibratePin__AG, CYREG_PRT5_AG
.set calibratePin__AMUX, CYREG_PRT5_AMUX
.set calibratePin__BIE, CYREG_PRT5_BIE
.set calibratePin__BIT_MASK, CYREG_PRT5_BIT_MASK
.set calibratePin__BYP, CYREG_PRT5_BYP
.set calibratePin__CTL, CYREG_PRT5_CTL
.set calibratePin__DM0, CYREG_PRT5_DM0
.set calibratePin__DM1, CYREG_PRT5_DM1
.set calibratePin__DM2, CYREG_PRT5_DM2
.set calibratePin__DR, CYREG_PRT5_DR
.set calibratePin__INP_DIS, CYREG_PRT5_INP_DIS
.set calibratePin__INTTYPE_BASE, CYDEV_PICU_INTTYPE_PICU5_BASE
.set calibratePin__LCD_COM_SEG, CYREG_PRT5_LCD_COM_SEG
.set calibratePin__LCD_EN, CYREG_PRT5_LCD_EN
.set calibratePin__MASK, 0x04
.set calibratePin__PORT, 5
.set calibratePin__PRT, CYREG_PRT5_PRT
.set calibratePin__PRTDSI__CAPS_SEL, CYREG_PRT5_CAPS_SEL
.set calibratePin__PRTDSI__DBL_SYNC_IN, CYREG_PRT5_DBL_SYNC_IN
.set calibratePin__PRTDSI__OE_SEL0, CYREG_PRT5_OE_SEL0
.set calibratePin__PRTDSI__OE_SEL1, CYREG_PRT5_OE_SEL1
.set calibratePin__PRTDSI__OUT_SEL0, CYREG_PRT5_OUT_SEL0
.set calibratePin__PRTDSI__OUT_SEL1, CYREG_PRT5_OUT_SEL1
.set calibratePin__PRTDSI__SYNC_OUT, CYREG_PRT5_SYNC_OUT
.set calibratePin__PS, CYREG_PRT5_PS
.set calibratePin__SHIFT, 2
.set calibratePin__SLW, CYREG_PRT5_SLW

/* coarseDACOut */
.set coarseDACOut__0__INTTYPE, CYREG_PICU0_INTTYPE6
.set coarseDACOut__0__MASK, 0x40
.set coarseDACOut__0__PC, CYREG_PRT0_PC6
.set coarseDACOut__0__PORT, 0
.set coarseDACOut__0__SHIFT, 6
.set coarseDACOut__AG, CYREG_PRT0_AG
.set coarseDACOut__AMUX, CYREG_PRT0_AMUX
.set coarseDACOut__BIE, CYREG_PRT0_BIE
.set coarseDACOut__BIT_MASK, CYREG_PRT0_BIT_MASK
.set coarseDACOut__BYP, CYREG_PRT0_BYP
.set coarseDACOut__CTL, CYREG_PRT0_CTL
.set coarseDACOut__DM0, CYREG_PRT0_DM0
.set coarseDACOut__DM1, CYREG_PRT0_DM1
.set coarseDACOut__DM2, CYREG_PRT0_DM2
.set coarseDACOut__DR, CYREG_PRT0_DR
.set coarseDACOut__INP_DIS, CYREG_PRT0_INP_DIS
.set coarseDACOut__INTTYPE_BASE, CYDEV_PICU_INTTYPE_PICU0_BASE
.set coarseDACOut__LCD_COM_SEG, CYREG_PRT0_LCD_COM_SEG
.set coarseDACOut__LCD_EN, CYREG_PRT0_LCD_EN
.set coarseDACOut__MASK, 0x40
.set coarseDACOut__PORT, 0
.set coarseDACOut__PRT, CYREG_PRT0_PRT
.set coarseDACOut__PRTDSI__CAPS_SEL, CYREG_PRT0_CAPS_SEL
.set coarseDACOut__PRTDSI__DBL_SYNC_IN, CYREG_PRT0_DBL_SYNC_IN
.set coarseDACOut__PRTDSI__OE_SEL0, CYREG_PRT0_OE_SEL0
.set coarseDACOut__PRTDSI__OE_SEL1, CYREG_PRT0_OE_SEL1
.set coarseDACOut__PRTDSI__OUT_SEL0, CYREG_PRT0_OUT_SEL0
.set coarseDACOut__PRTDSI__OUT_SEL1, CYREG_PRT0_OUT_SEL1
.set coarseDACOut__PRTDSI__SYNC_OUT, CYREG_PRT0_SYNC_OUT
.set coarseDACOut__PS, CYREG_PRT0_PS
.set coarseDACOut__SHIFT, 6
.set coarseDACOut__SLW, CYREG_PRT0_SLW

/* sampleErrorMonitor */
.set sampleErrorMonitor__0__INTTYPE, CYREG_PICU5_INTTYPE4
.set sampleErrorMonitor__0__MASK, 0x10
.set sampleErrorMonitor__0__PC, CYREG_PRT5_PC4
.set sampleErrorMonitor__0__PORT, 5
.set sampleErrorMonitor__0__SHIFT, 4
.set sampleErrorMonitor__AG, CYREG_PRT5_AG
.set sampleErrorMonitor__AMUX, CYREG_PRT5_AMUX
.set sampleErrorMonitor__BIE, CYREG_PRT5_BIE
.set sampleErrorMonitor__BIT_MASK, CYREG_PRT5_BIT_MASK
.set sampleErrorMonitor__BYP, CYREG_PRT5_BYP
.set sampleErrorMonitor__CTL, CYREG_PRT5_CTL
.set sampleErrorMonitor__DM0, CYREG_PRT5_DM0
.set sampleErrorMonitor__DM1, CYREG_PRT5_DM1
.set sampleErrorMonitor__DM2, CYREG_PRT5_DM2
.set sampleErrorMonitor__DR, CYREG_PRT5_DR
.set sampleErrorMonitor__INP_DIS, CYREG_PRT5_INP_DIS
.set sampleErrorMonitor__INTTYPE_BASE, CYDEV_PICU_INTTYPE_PICU5_BASE
.set sampleErrorMonitor__LCD_COM_SEG, CYREG_PRT5_LCD_COM_SEG
.set sampleErrorMonitor__LCD_EN, CYREG_PRT5_LCD_EN
.set sampleErrorMonitor__MASK, 0x10
.set sampleErrorMonitor__PORT, 5
.set sampleErrorMonitor__PRT, CYREG_PRT5_PRT
.set sampleErrorMonitor__PRTDSI__CAPS_SEL, CYREG_PRT5_CAPS_SEL
.set sampleErrorMonitor__PRTDSI__DBL_SYNC_IN, CYREG_PRT5_DBL_SYNC_IN
.set sampleErrorMonitor__PRTDSI__OE_SEL0, CYREG_PRT5_OE_SEL0
.set sampleErrorMonitor__PRTDSI__OE_SEL1, CYREG_PRT5_OE_SEL1
.set sampleErrorMonitor__PRTDSI__OUT_SEL0, CYREG_PRT5_OUT_SEL0
.set sampleErrorMonitor__PRTDSI__OUT_SEL1, CYREG_PRT5_OUT_SEL1
.set sampleErrorMonitor__PRTDSI__SYNC_OUT, CYREG_PRT5_SYNC_OUT
.set sampleErrorMonitor__PS, CYREG_PRT5_PS
.set sampleErrorMonitor__SHIFT, 4
.set sampleErrorMonitor__SLW, CYREG_PRT5_SLW

/* Miscellaneous */
.set BCLK__BUS_CLK__HZ, 24000000
.set BCLK__BUS_CLK__KHZ, 24000
.set BCLK__BUS_CLK__MHZ, 24
.set CYDEV_CHIP_DIE_LEOPARD, 1
.set CYDEV_CHIP_DIE_PSOC4A, 18
.set CYDEV_CHIP_DIE_PSOC5LP, 2
.set CYDEV_CHIP_DIE_PSOC5TM, 3
.set CYDEV_CHIP_DIE_TMA4, 4
.set CYDEV_CHIP_DIE_UNKNOWN, 0
.set CYDEV_CHIP_FAMILY_FM0P, 5
.set CYDEV_CHIP_FAMILY_FM3, 6
.set CYDEV_CHIP_FAMILY_FM4, 7
.set CYDEV_CHIP_FAMILY_PSOC3, 1
.set CYDEV_CHIP_FAMILY_PSOC4, 2
.set CYDEV_CHIP_FAMILY_PSOC5, 3
.set CYDEV_CHIP_FAMILY_PSOC6, 4
.set CYDEV_CHIP_FAMILY_UNKNOWN, 0
.set CYDEV_CHIP_FAMILY_USED, CYDEV_CHIP_FAMILY_PSOC5
.set CYDEV_CHIP_JTAG_ID, 0x2E123069
.set CYDEV_CHIP_MEMBER_3A, 1
.set CYDEV_CHIP_MEMBER_4A, 18
.set CYDEV_CHIP_MEMBER_4D, 13
.set CYDEV_CHIP_MEMBER_4E, 6
.set CYDEV_CHIP_MEMBER_4F, 19
.set CYDEV_CHIP_MEMBER_4G, 4
.set CYDEV_CHIP_MEMBER_4H, 17
.set CYDEV_CHIP_MEMBER_4I, 23
.set CYDEV_CHIP_MEMBER_4J, 14
.set CYDEV_CHIP_MEMBER_4K, 15
.set CYDEV_CHIP_MEMBER_4L, 22
.set CYDEV_CHIP_MEMBER_4M, 21
.set CYDEV_CHIP_MEMBER_4N, 10
.set CYDEV_CHIP_MEMBER_4O, 7
.set CYDEV_CHIP_MEMBER_4P, 20
.set CYDEV_CHIP_MEMBER_4Q, 12
.set CYDEV_CHIP_MEMBER_4R, 8
.set CYDEV_CHIP_MEMBER_4S, 11
.set CYDEV_CHIP_MEMBER_4T, 9
.set CYDEV_CHIP_MEMBER_4U, 5
.set CYDEV_CHIP_MEMBER_4V, 16
.set CYDEV_CHIP_MEMBER_5A, 3
.set CYDEV_CHIP_MEMBER_5B, 2
.set CYDEV_CHIP_MEMBER_6A, 24
.set CYDEV_CHIP_MEMBER_FM3, 28
.set CYDEV_CHIP_MEMBER_FM4, 29
.set CYDEV_CHIP_MEMBER_PDL_FM0P_TYPE1, 25
.set CYDEV_CHIP_MEMBER_PDL_FM0P_TYPE2, 26
.set CYDEV_CHIP_MEMBER_PDL_FM0P_TYPE3, 27
.set CYDEV_CHIP_MEMBER_UNKNOWN, 0
.set CYDEV_CHIP_MEMBER_USED, CYDEV_CHIP_MEMBER_5B
.set CYDEV_CHIP_DIE_EXPECT, CYDEV_CHIP_MEMBER_USED
.set CYDEV_CHIP_DIE_ACTUAL, CYDEV_CHIP_DIE_EXPECT
.set CYDEV_CHIP_REV_LEOPARD_ES1, 0
.set CYDEV_CHIP_REV_LEOPARD_ES2, 1
.set CYDEV_CHIP_REV_LEOPARD_ES3, 3
.set CYDEV_CHIP_REV_LEOPARD_PRODUCTION, 3
.set CYDEV_CHIP_REV_PSOC4A_ES0, 17
.set CYDEV_CHIP_REV_PSOC4A_PRODUCTION, 17
.set CYDEV_CHIP_REV_PSOC5LP_ES0, 0
.set CYDEV_CHIP_REV_PSOC5LP_PRODUCTION, 0
.set CYDEV_CHIP_REV_PSOC5TM_ES0, 0
.set CYDEV_CHIP_REV_PSOC5TM_ES1, 1
.set CYDEV_CHIP_REV_PSOC5TM_PRODUCTION, 1
.set CYDEV_CHIP_REV_TMA4_ES, 17
.set CYDEV_CHIP_REV_TMA4_ES2, 33
.set CYDEV_CHIP_REV_TMA4_PRODUCTION, 17
.set CYDEV_CHIP_REVISION_3A_ES1, 0
.set CYDEV_CHIP_REVISION_3A_ES2, 1
.set CYDEV_CHIP_REVISION_3A_ES3, 3
.set CYDEV_CHIP_REVISION_3A_PRODUCTION, 3
.set CYDEV_CHIP_REVISION_4A_ES0, 17
.set CYDEV_CHIP_REVISION_4A_PRODUCTION, 17
.set CYDEV_CHIP_REVISION_4D_PRODUCTION, 0
.set CYDEV_CHIP_REVISION_4E_CCG2_NO_USBPD, 0
.set CYDEV_CHIP_REVISION_4E_PRODUCTION, 0
.set CYDEV_CHIP_REVISION_4F_PRODUCTION, 0
.set CYDEV_CHIP_REVISION_4F_PRODUCTION_256DMA, 0
.set CYDEV_CHIP_REVISION_4F_PRODUCTION_256K, 0
.set CYDEV_CHIP_REVISION_4G_ES, 17
.set CYDEV_CHIP_REVISION_4G_ES2, 33
.set CYDEV_CHIP_REVISION_4G_PRODUCTION, 17
.set CYDEV_CHIP_REVISION_4H_PRODUCTION, 0
.set CYDEV_CHIP_REVISION_4I_PRODUCTION, 0
.set CYDEV_CHIP_REVISION_4J_PRODUCTION, 0
.set CYDEV_CHIP_REVISION_4K_PRODUCTION, 0
.set CYDEV_CHIP_REVISION_4L_PRODUCTION, 0
.set CYDEV_CHIP_REVISION_4M_PRODUCTION, 0
.set CYDEV_CHIP_REVISION_4N_PRODUCTION, 0
.set CYDEV_CHIP_REVISION_4O_PRODUCTION, 0
.set CYDEV_CHIP_REVISION_4P_PRODUCTION, 0
.set CYDEV_CHIP_REVISION_4Q_PRODUCTION, 0
.set CYDEV_CHIP_REVISION_4R_PRODUCTION, 0
.set CYDEV_CHIP_REVISION_4S_PRODUCTION, 0
.set CYDEV_CHIP_REVISION_4T_PRODUCTION, 0
.set CYDEV_CHIP_REVISION_4U_PRODUCTION, 0
.set CYDEV_CHIP_REVISION_4V_PRODUCTION, 0
.set CYDEV_CHIP_REVISION_5A_ES0, 0
.set CYDEV_CHIP_REVISION_5A_ES1, 1
.set CYDEV_CHIP_REVISION_5A_PRODUCTION, 1
.set CYDEV_CHIP_REVISION_5B_ES0, 0
.set CYDEV_CHIP_REVISION_5B_PRODUCTION, 0
.set CYDEV_CHIP_REVISION_6A_ES, 17
.set CYDEV_CHIP_REVISION_6A_NO_UDB, 33
.set CYDEV_CHIP_REVISION_6A_PRODUCTION, 33
.set CYDEV_CHIP_REVISION_FM3_PRODUCTION, 0
.set CYDEV_CHIP_REVISION_FM4_PRODUCTION, 0
.set CYDEV_CHIP_REVISION_PDL_FM0P_TYPE1_PRODUCTION, 0
.set CYDEV_CHIP_REVISION_PDL_FM0P_TYPE2_PRODUCTION, 0
.set CYDEV_CHIP_REVISION_PDL_FM0P_TYPE3_PRODUCTION, 0
.set CYDEV_CHIP_REVISION_USED, CYDEV_CHIP_REVISION_5B_PRODUCTION
.set CYDEV_CHIP_REV_EXPECT, CYDEV_CHIP_REVISION_USED
.set CYDEV_CONFIG_FASTBOOT_ENABLED, 1
.set CYDEV_CONFIG_UNUSED_IO_AllowButWarn, 0
.set CYDEV_CONFIG_UNUSED_IO, CYDEV_CONFIG_UNUSED_IO_AllowButWarn
.set CYDEV_CONFIG_UNUSED_IO_AllowWithInfo, 1
.set CYDEV_CONFIG_UNUSED_IO_Disallowed, 2
.set CYDEV_CONFIGURATION_COMPRESSED, 1
.set CYDEV_CONFIGURATION_DMA, 0
.set CYDEV_CONFIGURATION_ECC, 1
.set CYDEV_CONFIGURATION_IMOENABLED, CYDEV_CONFIG_FASTBOOT_ENABLED
.set CYDEV_CONFIGURATION_MODE_COMPRESSED, 0
.set CYDEV_CONFIGURATION_MODE, CYDEV_CONFIGURATION_MODE_COMPRESSED
.set CYDEV_CONFIGURATION_MODE_DMA, 2
.set CYDEV_CONFIGURATION_MODE_UNCOMPRESSED, 1
.set CYDEV_DEBUG_ENABLE_MASK, 0x20
.set CYDEV_DEBUG_ENABLE_REGISTER, CYREG_MLOGIC_DEBUG
.set CYDEV_DEBUGGING_DPS_Disable, 3
.set CYDEV_DEBUGGING_DPS_JTAG_4, 1
.set CYDEV_DEBUGGING_DPS_JTAG_5, 0
.set CYDEV_DEBUGGING_DPS_SWD, 2
.set CYDEV_DEBUGGING_DPS_SWD_SWV, 6
.set CYDEV_DEBUGGING_DPS, CYDEV_DEBUGGING_DPS_SWD_SWV
.set CYDEV_DEBUGGING_ENABLE, 1
.set CYDEV_DEBUGGING_XRES, 0
.set CYDEV_DMA_CHANNELS_AVAILABLE, 24
.set CYDEV_ECC_ENABLE, 0
.set CYDEV_HEAP_SIZE, 0x0200
.set CYDEV_INSTRUCT_CACHE_ENABLED, 1
.set CYDEV_INTR_RISING, 0x00000001
.set CYDEV_IS_EXPORTING_CODE, 0
.set CYDEV_IS_IMPORTING_CODE, 0
.set CYDEV_PROJ_TYPE, 0
.set CYDEV_PROJ_TYPE_BOOTLOADER, 1
.set CYDEV_PROJ_TYPE_LAUNCHER, 5
.set CYDEV_PROJ_TYPE_LOADABLE, 2
.set CYDEV_PROJ_TYPE_LOADABLEANDBOOTLOADER, 4
.set CYDEV_PROJ_TYPE_MULTIAPPBOOTLOADER, 3
.set CYDEV_PROJ_TYPE_STANDARD, 0
.set CYDEV_PROTECTION_ENABLE, 0
.set CYDEV_STACK_SIZE, 0x0800
.set CYDEV_USE_BUNDLED_CMSIS, 1
.set CYDEV_VARIABLE_VDDA, 0
.set CYDEV_VDDA_MV, 5000
.set CYDEV_VDDD_MV, 5000
.set CYDEV_VDDIO0_MV, 5000
.set CYDEV_VDDIO1_MV, 5000
.set CYDEV_VDDIO2_MV, 5000
.set CYDEV_VDDIO3_MV, 5000
.set CYDEV_VIO0_MV, 5000
.set CYDEV_VIO1_MV, 5000
.set CYDEV_VIO2_MV, 5000
.set CYDEV_VIO3_MV, 5000
.set CYIPBLOCK_ARM_CM3_VERSION, 0
.set CYIPBLOCK_P3_ANAIF_VERSION, 0
.set CYIPBLOCK_P3_CAN_VERSION, 0
.set CYIPBLOCK_P3_CAPSENSE_VERSION, 0
.set CYIPBLOCK_P3_COMP_VERSION, 0
.set CYIPBLOCK_P3_DECIMATOR_VERSION, 0
.set CYIPBLOCK_P3_DFB_VERSION, 0
.set CYIPBLOCK_P3_DMA_VERSION, 0
.set CYIPBLOCK_P3_DRQ_VERSION, 0
.set CYIPBLOCK_P3_DSM_VERSION, 0
.set CYIPBLOCK_P3_EMIF_VERSION, 0
.set CYIPBLOCK_P3_I2C_VERSION, 0
.set CYIPBLOCK_P3_LCD_VERSION, 0
.set CYIPBLOCK_P3_LPF_VERSION, 0
.set CYIPBLOCK_P3_OPAMP_VERSION, 0
.set CYIPBLOCK_P3_PM_VERSION, 0
.set CYIPBLOCK_P3_SCCT_VERSION, 0
.set CYIPBLOCK_P3_TIMER_VERSION, 0
.set CYIPBLOCK_P3_USB_VERSION, 0
.set CYIPBLOCK_P3_VIDAC_VERSION, 0
.set CYIPBLOCK_P3_VREF_VERSION, 0
.set CYIPBLOCK_S8_GPIO_VERSION, 0
.set CYIPBLOCK_S8_IRQ_VERSION, 0
.set CYIPBLOCK_S8_SAR_VERSION, 0
.set CYIPBLOCK_S8_SIO_VERSION, 0
.set CYIPBLOCK_S8_UDB_VERSION, 0
.set DMA_CHANNELS_USED__MASK0, 0x00000000
.set CYDEV_BOOTLOADER_ENABLE, 0
.endif
