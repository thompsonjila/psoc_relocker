;
; File Name: cyfitteriar.inc
; 
; PSoC Creator  4.2
;
; Description:
; 
;
;-------------------------------------------------------------------------------
; Copyright (c) 2007-2018 Cypress Semiconductor.  All rights reserved.
; You may use this file only in accordance with the license, terms, conditions, 
; disclaimers, and limitations in the end user license agreement accompanying 
; the software package with which this file was provided.
;-------------------------------------------------------------------------------

#ifndef INCLUDED_CYFITTERIAR_INC
#define INCLUDED_CYFITTERIAR_INC
    INCLUDE cydeviceiar.inc
    INCLUDE cydeviceiar_trm.inc

/* aPin */
aPin__0__INTTYPE EQU CYREG_PICU0_INTTYPE7
aPin__0__MASK EQU 0x80
aPin__0__PC EQU CYREG_PRT0_PC7
aPin__0__PORT EQU 0
aPin__0__SHIFT EQU 7
aPin__AG EQU CYREG_PRT0_AG
aPin__AMUX EQU CYREG_PRT0_AMUX
aPin__BIE EQU CYREG_PRT0_BIE
aPin__BIT_MASK EQU CYREG_PRT0_BIT_MASK
aPin__BYP EQU CYREG_PRT0_BYP
aPin__CTL EQU CYREG_PRT0_CTL
aPin__DM0 EQU CYREG_PRT0_DM0
aPin__DM1 EQU CYREG_PRT0_DM1
aPin__DM2 EQU CYREG_PRT0_DM2
aPin__DR EQU CYREG_PRT0_DR
aPin__INP_DIS EQU CYREG_PRT0_INP_DIS
aPin__INTTYPE_BASE EQU CYDEV_PICU_INTTYPE_PICU0_BASE
aPin__LCD_COM_SEG EQU CYREG_PRT0_LCD_COM_SEG
aPin__LCD_EN EQU CYREG_PRT0_LCD_EN
aPin__MASK EQU 0x80
aPin__PORT EQU 0
aPin__PRT EQU CYREG_PRT0_PRT
aPin__PRTDSI__CAPS_SEL EQU CYREG_PRT0_CAPS_SEL
aPin__PRTDSI__DBL_SYNC_IN EQU CYREG_PRT0_DBL_SYNC_IN
aPin__PRTDSI__OE_SEL0 EQU CYREG_PRT0_OE_SEL0
aPin__PRTDSI__OE_SEL1 EQU CYREG_PRT0_OE_SEL1
aPin__PRTDSI__OUT_SEL0 EQU CYREG_PRT0_OUT_SEL0
aPin__PRTDSI__OUT_SEL1 EQU CYREG_PRT0_OUT_SEL1
aPin__PRTDSI__SYNC_OUT EQU CYREG_PRT0_SYNC_OUT
aPin__PS EQU CYREG_PRT0_PS
aPin__SHIFT EQU 7
aPin__SLW EQU CYREG_PRT0_SLW

/* bPin */
bPin__0__INTTYPE EQU CYREG_PICU0_INTTYPE5
bPin__0__MASK EQU 0x20
bPin__0__PC EQU CYREG_PRT0_PC5
bPin__0__PORT EQU 0
bPin__0__SHIFT EQU 5
bPin__AG EQU CYREG_PRT0_AG
bPin__AMUX EQU CYREG_PRT0_AMUX
bPin__BIE EQU CYREG_PRT0_BIE
bPin__BIT_MASK EQU CYREG_PRT0_BIT_MASK
bPin__BYP EQU CYREG_PRT0_BYP
bPin__CTL EQU CYREG_PRT0_CTL
bPin__DM0 EQU CYREG_PRT0_DM0
bPin__DM1 EQU CYREG_PRT0_DM1
bPin__DM2 EQU CYREG_PRT0_DM2
bPin__DR EQU CYREG_PRT0_DR
bPin__INP_DIS EQU CYREG_PRT0_INP_DIS
bPin__INTTYPE_BASE EQU CYDEV_PICU_INTTYPE_PICU0_BASE
bPin__LCD_COM_SEG EQU CYREG_PRT0_LCD_COM_SEG
bPin__LCD_EN EQU CYREG_PRT0_LCD_EN
bPin__MASK EQU 0x20
bPin__PORT EQU 0
bPin__PRT EQU CYREG_PRT0_PRT
bPin__PRTDSI__CAPS_SEL EQU CYREG_PRT0_CAPS_SEL
bPin__PRTDSI__DBL_SYNC_IN EQU CYREG_PRT0_DBL_SYNC_IN
bPin__PRTDSI__OE_SEL0 EQU CYREG_PRT0_OE_SEL0
bPin__PRTDSI__OE_SEL1 EQU CYREG_PRT0_OE_SEL1
bPin__PRTDSI__OUT_SEL0 EQU CYREG_PRT0_OUT_SEL0
bPin__PRTDSI__OUT_SEL1 EQU CYREG_PRT0_OUT_SEL1
bPin__PRTDSI__SYNC_OUT EQU CYREG_PRT0_SYNC_OUT
bPin__PS EQU CYREG_PRT0_PS
bPin__SHIFT EQU 5
bPin__SLW EQU CYREG_PRT0_SLW

/* fineDAC */
fineDAC_viDAC8__CR0 EQU CYREG_DAC3_CR0
fineDAC_viDAC8__CR1 EQU CYREG_DAC3_CR1
fineDAC_viDAC8__D EQU CYREG_DAC3_D
fineDAC_viDAC8__PM_ACT_CFG EQU CYREG_PM_ACT_CFG8
fineDAC_viDAC8__PM_ACT_MSK EQU 0x08
fineDAC_viDAC8__PM_STBY_CFG EQU CYREG_PM_STBY_CFG8
fineDAC_viDAC8__PM_STBY_MSK EQU 0x08
fineDAC_viDAC8__STROBE EQU CYREG_DAC3_STROBE
fineDAC_viDAC8__SW0 EQU CYREG_DAC3_SW0
fineDAC_viDAC8__SW2 EQU CYREG_DAC3_SW2
fineDAC_viDAC8__SW3 EQU CYREG_DAC3_SW3
fineDAC_viDAC8__SW4 EQU CYREG_DAC3_SW4
fineDAC_viDAC8__TR EQU CYREG_DAC3_TR
fineDAC_viDAC8__TRIM__M1 EQU CYREG_FLSHID_CUST_TABLES_DAC3_M1
fineDAC_viDAC8__TRIM__M2 EQU CYREG_FLSHID_CUST_TABLES_DAC3_M2
fineDAC_viDAC8__TRIM__M3 EQU CYREG_FLSHID_CUST_TABLES_DAC3_M3
fineDAC_viDAC8__TRIM__M4 EQU CYREG_FLSHID_CUST_TABLES_DAC3_M4
fineDAC_viDAC8__TRIM__M5 EQU CYREG_FLSHID_CUST_TABLES_DAC3_M5
fineDAC_viDAC8__TRIM__M6 EQU CYREG_FLSHID_CUST_TABLES_DAC3_M6
fineDAC_viDAC8__TRIM__M7 EQU CYREG_FLSHID_CUST_TABLES_DAC3_M7
fineDAC_viDAC8__TRIM__M8 EQU CYREG_FLSHID_CUST_TABLES_DAC3_M8
fineDAC_viDAC8__TST EQU CYREG_DAC3_TST

/* LFOutADC */
LFOutADC_DEC__COHER EQU CYREG_DEC_COHER
LFOutADC_DEC__CR EQU CYREG_DEC_CR
LFOutADC_DEC__DR1 EQU CYREG_DEC_DR1
LFOutADC_DEC__DR2 EQU CYREG_DEC_DR2
LFOutADC_DEC__DR2H EQU CYREG_DEC_DR2H
LFOutADC_DEC__GCOR EQU CYREG_DEC_GCOR
LFOutADC_DEC__GCORH EQU CYREG_DEC_GCORH
LFOutADC_DEC__GVAL EQU CYREG_DEC_GVAL
LFOutADC_DEC__OCOR EQU CYREG_DEC_OCOR
LFOutADC_DEC__OCORH EQU CYREG_DEC_OCORH
LFOutADC_DEC__OCORM EQU CYREG_DEC_OCORM
LFOutADC_DEC__OUTSAMP EQU CYREG_DEC_OUTSAMP
LFOutADC_DEC__OUTSAMPH EQU CYREG_DEC_OUTSAMPH
LFOutADC_DEC__OUTSAMPM EQU CYREG_DEC_OUTSAMPM
LFOutADC_DEC__OUTSAMPS EQU CYREG_DEC_OUTSAMPS
LFOutADC_DEC__PM_ACT_CFG EQU CYREG_PM_ACT_CFG10
LFOutADC_DEC__PM_ACT_MSK EQU 0x01
LFOutADC_DEC__PM_STBY_CFG EQU CYREG_PM_STBY_CFG10
LFOutADC_DEC__PM_STBY_MSK EQU 0x01
LFOutADC_DEC__SHIFT1 EQU CYREG_DEC_SHIFT1
LFOutADC_DEC__SHIFT2 EQU CYREG_DEC_SHIFT2
LFOutADC_DEC__SR EQU CYREG_DEC_SR
LFOutADC_DEC__TRIM__M1 EQU CYREG_FLSHID_CUST_TABLES_DEC_M1
LFOutADC_DEC__TRIM__M2 EQU CYREG_FLSHID_CUST_TABLES_DEC_M2
LFOutADC_DEC__TRIM__M3 EQU CYREG_FLSHID_CUST_TABLES_DEC_M3
LFOutADC_DEC__TRIM__M4 EQU CYREG_FLSHID_CUST_TABLES_DEC_M4
LFOutADC_DEC__TRIM__M5 EQU CYREG_FLSHID_CUST_TABLES_DEC_M5
LFOutADC_DEC__TRIM__M6 EQU CYREG_FLSHID_CUST_TABLES_DEC_M6
LFOutADC_DEC__TRIM__M7 EQU CYREG_FLSHID_CUST_TABLES_DEC_M7
LFOutADC_DEC__TRIM__M8 EQU CYREG_FLSHID_CUST_TABLES_DEC_M8
LFOutADC_DSM__BUF0 EQU CYREG_DSM0_BUF0
LFOutADC_DSM__BUF1 EQU CYREG_DSM0_BUF1
LFOutADC_DSM__BUF2 EQU CYREG_DSM0_BUF2
LFOutADC_DSM__BUF3 EQU CYREG_DSM0_BUF3
LFOutADC_DSM__CLK EQU CYREG_DSM0_CLK
LFOutADC_DSM__CR0 EQU CYREG_DSM0_CR0
LFOutADC_DSM__CR1 EQU CYREG_DSM0_CR1
LFOutADC_DSM__CR10 EQU CYREG_DSM0_CR10
LFOutADC_DSM__CR11 EQU CYREG_DSM0_CR11
LFOutADC_DSM__CR12 EQU CYREG_DSM0_CR12
LFOutADC_DSM__CR13 EQU CYREG_DSM0_CR13
LFOutADC_DSM__CR14 EQU CYREG_DSM0_CR14
LFOutADC_DSM__CR15 EQU CYREG_DSM0_CR15
LFOutADC_DSM__CR16 EQU CYREG_DSM0_CR16
LFOutADC_DSM__CR17 EQU CYREG_DSM0_CR17
LFOutADC_DSM__CR2 EQU CYREG_DSM0_CR2
LFOutADC_DSM__CR3 EQU CYREG_DSM0_CR3
LFOutADC_DSM__CR4 EQU CYREG_DSM0_CR4
LFOutADC_DSM__CR5 EQU CYREG_DSM0_CR5
LFOutADC_DSM__CR6 EQU CYREG_DSM0_CR6
LFOutADC_DSM__CR7 EQU CYREG_DSM0_CR7
LFOutADC_DSM__CR8 EQU CYREG_DSM0_CR8
LFOutADC_DSM__CR9 EQU CYREG_DSM0_CR9
LFOutADC_DSM__DEM0 EQU CYREG_DSM0_DEM0
LFOutADC_DSM__DEM1 EQU CYREG_DSM0_DEM1
LFOutADC_DSM__MISC EQU CYREG_DSM0_MISC
LFOutADC_DSM__OUT0 EQU CYREG_DSM0_OUT0
LFOutADC_DSM__OUT1 EQU CYREG_DSM0_OUT1
LFOutADC_DSM__REF0 EQU CYREG_DSM0_REF0
LFOutADC_DSM__REF1 EQU CYREG_DSM0_REF1
LFOutADC_DSM__REF2 EQU CYREG_DSM0_REF2
LFOutADC_DSM__REF3 EQU CYREG_DSM0_REF3
LFOutADC_DSM__RSVD1 EQU CYREG_DSM0_RSVD1
LFOutADC_DSM__SW0 EQU CYREG_DSM0_SW0
LFOutADC_DSM__SW2 EQU CYREG_DSM0_SW2
LFOutADC_DSM__SW3 EQU CYREG_DSM0_SW3
LFOutADC_DSM__SW4 EQU CYREG_DSM0_SW4
LFOutADC_DSM__SW6 EQU CYREG_DSM0_SW6
LFOutADC_DSM__TR0 EQU CYREG_NPUMP_DSM_TR0
LFOutADC_DSM__TST0 EQU CYREG_DSM0_TST0
LFOutADC_DSM__TST1 EQU CYREG_DSM0_TST1
LFOutADC_Ext_CP_Clk__CFG0 EQU CYREG_CLKDIST_DCFG0_CFG0
LFOutADC_Ext_CP_Clk__CFG1 EQU CYREG_CLKDIST_DCFG0_CFG1
LFOutADC_Ext_CP_Clk__CFG2 EQU CYREG_CLKDIST_DCFG0_CFG2
LFOutADC_Ext_CP_Clk__CFG2_SRC_SEL_MASK EQU 0x07
LFOutADC_Ext_CP_Clk__INDEX EQU 0x00
LFOutADC_Ext_CP_Clk__PM_ACT_CFG EQU CYREG_PM_ACT_CFG2
LFOutADC_Ext_CP_Clk__PM_ACT_MSK EQU 0x01
LFOutADC_Ext_CP_Clk__PM_STBY_CFG EQU CYREG_PM_STBY_CFG2
LFOutADC_Ext_CP_Clk__PM_STBY_MSK EQU 0x01
LFOutADC_IRQ__INTC_CLR_EN_REG EQU CYREG_NVIC_CLRENA0
LFOutADC_IRQ__INTC_CLR_PD_REG EQU CYREG_NVIC_CLRPEND0
LFOutADC_IRQ__INTC_MASK EQU 0x20000000
LFOutADC_IRQ__INTC_NUMBER EQU 29
LFOutADC_IRQ__INTC_PRIOR_NUM EQU 7
LFOutADC_IRQ__INTC_PRIOR_REG EQU CYREG_NVIC_PRI_29
LFOutADC_IRQ__INTC_SET_EN_REG EQU CYREG_NVIC_SETENA0
LFOutADC_IRQ__INTC_SET_PD_REG EQU CYREG_NVIC_SETPEND0
LFOutADC_theACLK__CFG0 EQU CYREG_CLKDIST_ACFG1_CFG0
LFOutADC_theACLK__CFG1 EQU CYREG_CLKDIST_ACFG1_CFG1
LFOutADC_theACLK__CFG2 EQU CYREG_CLKDIST_ACFG1_CFG2
LFOutADC_theACLK__CFG2_SRC_SEL_MASK EQU 0x07
LFOutADC_theACLK__CFG3 EQU CYREG_CLKDIST_ACFG1_CFG3
LFOutADC_theACLK__CFG3_PHASE_DLY_MASK EQU 0x0F
LFOutADC_theACLK__INDEX EQU 0x01
LFOutADC_theACLK__PM_ACT_CFG EQU CYREG_PM_ACT_CFG1
LFOutADC_theACLK__PM_ACT_MSK EQU 0x02
LFOutADC_theACLK__PM_STBY_CFG EQU CYREG_PM_STBY_CFG1
LFOutADC_theACLK__PM_STBY_MSK EQU 0x02

/* LFOutPin */
LFOutPin__0__INTTYPE EQU CYREG_PICU0_INTTYPE1
LFOutPin__0__MASK EQU 0x02
LFOutPin__0__PC EQU CYREG_PRT0_PC1
LFOutPin__0__PORT EQU 0
LFOutPin__0__SHIFT EQU 1
LFOutPin__AG EQU CYREG_PRT0_AG
LFOutPin__AMUX EQU CYREG_PRT0_AMUX
LFOutPin__BIE EQU CYREG_PRT0_BIE
LFOutPin__BIT_MASK EQU CYREG_PRT0_BIT_MASK
LFOutPin__BYP EQU CYREG_PRT0_BYP
LFOutPin__CTL EQU CYREG_PRT0_CTL
LFOutPin__DM0 EQU CYREG_PRT0_DM0
LFOutPin__DM1 EQU CYREG_PRT0_DM1
LFOutPin__DM2 EQU CYREG_PRT0_DM2
LFOutPin__DR EQU CYREG_PRT0_DR
LFOutPin__INP_DIS EQU CYREG_PRT0_INP_DIS
LFOutPin__INTTYPE_BASE EQU CYDEV_PICU_INTTYPE_PICU0_BASE
LFOutPin__LCD_COM_SEG EQU CYREG_PRT0_LCD_COM_SEG
LFOutPin__LCD_EN EQU CYREG_PRT0_LCD_EN
LFOutPin__MASK EQU 0x02
LFOutPin__PORT EQU 0
LFOutPin__PRT EQU CYREG_PRT0_PRT
LFOutPin__PRTDSI__CAPS_SEL EQU CYREG_PRT0_CAPS_SEL
LFOutPin__PRTDSI__DBL_SYNC_IN EQU CYREG_PRT0_DBL_SYNC_IN
LFOutPin__PRTDSI__OE_SEL0 EQU CYREG_PRT0_OE_SEL0
LFOutPin__PRTDSI__OE_SEL1 EQU CYREG_PRT0_OE_SEL1
LFOutPin__PRTDSI__OUT_SEL0 EQU CYREG_PRT0_OUT_SEL0
LFOutPin__PRTDSI__OUT_SEL1 EQU CYREG_PRT0_OUT_SEL1
LFOutPin__PRTDSI__SYNC_OUT EQU CYREG_PRT0_SYNC_OUT
LFOutPin__PS EQU CYREG_PRT0_PS
LFOutPin__SHIFT EQU 1
LFOutPin__SLW EQU CYREG_PRT0_SLW

/* redLight */
redLight__0__INTTYPE EQU CYREG_PICU5_INTTYPE1
redLight__0__MASK EQU 0x02
redLight__0__PC EQU CYREG_PRT5_PC1
redLight__0__PORT EQU 5
redLight__0__SHIFT EQU 1
redLight__AG EQU CYREG_PRT5_AG
redLight__AMUX EQU CYREG_PRT5_AMUX
redLight__BIE EQU CYREG_PRT5_BIE
redLight__BIT_MASK EQU CYREG_PRT5_BIT_MASK
redLight__BYP EQU CYREG_PRT5_BYP
redLight__CTL EQU CYREG_PRT5_CTL
redLight__DM0 EQU CYREG_PRT5_DM0
redLight__DM1 EQU CYREG_PRT5_DM1
redLight__DM2 EQU CYREG_PRT5_DM2
redLight__DR EQU CYREG_PRT5_DR
redLight__INP_DIS EQU CYREG_PRT5_INP_DIS
redLight__INTTYPE_BASE EQU CYDEV_PICU_INTTYPE_PICU5_BASE
redLight__LCD_COM_SEG EQU CYREG_PRT5_LCD_COM_SEG
redLight__LCD_EN EQU CYREG_PRT5_LCD_EN
redLight__MASK EQU 0x02
redLight__PORT EQU 5
redLight__PRT EQU CYREG_PRT5_PRT
redLight__PRTDSI__CAPS_SEL EQU CYREG_PRT5_CAPS_SEL
redLight__PRTDSI__DBL_SYNC_IN EQU CYREG_PRT5_DBL_SYNC_IN
redLight__PRTDSI__OE_SEL0 EQU CYREG_PRT5_OE_SEL0
redLight__PRTDSI__OE_SEL1 EQU CYREG_PRT5_OE_SEL1
redLight__PRTDSI__OUT_SEL0 EQU CYREG_PRT5_OUT_SEL0
redLight__PRTDSI__OUT_SEL1 EQU CYREG_PRT5_OUT_SEL1
redLight__PRTDSI__SYNC_OUT EQU CYREG_PRT5_SYNC_OUT
redLight__PS EQU CYREG_PRT5_PS
redLight__SHIFT EQU 1
redLight__SLW EQU CYREG_PRT5_SLW

/* switches */
switches_Sync_ctrl_reg__0__MASK EQU 0x01
switches_Sync_ctrl_reg__0__POS EQU 0
switches_Sync_ctrl_reg__16BIT_CONTROL_AUX_CTL_REG EQU CYREG_B0_UDB02_03_ACTL
switches_Sync_ctrl_reg__16BIT_CONTROL_CONTROL_REG EQU CYREG_B0_UDB02_03_CTL
switches_Sync_ctrl_reg__16BIT_CONTROL_COUNT_REG EQU CYREG_B0_UDB02_03_CTL
switches_Sync_ctrl_reg__16BIT_COUNT_CONTROL_REG EQU CYREG_B0_UDB02_03_CTL
switches_Sync_ctrl_reg__16BIT_COUNT_COUNT_REG EQU CYREG_B0_UDB02_03_CTL
switches_Sync_ctrl_reg__16BIT_MASK_MASK_REG EQU CYREG_B0_UDB02_03_MSK
switches_Sync_ctrl_reg__16BIT_MASK_PERIOD_REG EQU CYREG_B0_UDB02_03_MSK
switches_Sync_ctrl_reg__16BIT_PERIOD_MASK_REG EQU CYREG_B0_UDB02_03_MSK
switches_Sync_ctrl_reg__16BIT_PERIOD_PERIOD_REG EQU CYREG_B0_UDB02_03_MSK
switches_Sync_ctrl_reg__CONTROL_AUX_CTL_REG EQU CYREG_B0_UDB02_ACTL
switches_Sync_ctrl_reg__CONTROL_REG EQU CYREG_B0_UDB02_CTL
switches_Sync_ctrl_reg__CONTROL_ST_REG EQU CYREG_B0_UDB02_ST_CTL
switches_Sync_ctrl_reg__COUNT_REG EQU CYREG_B0_UDB02_CTL
switches_Sync_ctrl_reg__COUNT_ST_REG EQU CYREG_B0_UDB02_ST_CTL
switches_Sync_ctrl_reg__MASK EQU 0x01
switches_Sync_ctrl_reg__MASK_CTL_AUX_CTL_REG EQU CYREG_B0_UDB02_MSK_ACTL
switches_Sync_ctrl_reg__PER_CTL_AUX_CTL_REG EQU CYREG_B0_UDB02_MSK_ACTL
switches_Sync_ctrl_reg__PERIOD_REG EQU CYREG_B0_UDB02_MSK

/* coarseDAC */
coarseDAC_viDAC8__CR0 EQU CYREG_DAC0_CR0
coarseDAC_viDAC8__CR1 EQU CYREG_DAC0_CR1
coarseDAC_viDAC8__D EQU CYREG_DAC0_D
coarseDAC_viDAC8__PM_ACT_CFG EQU CYREG_PM_ACT_CFG8
coarseDAC_viDAC8__PM_ACT_MSK EQU 0x01
coarseDAC_viDAC8__PM_STBY_CFG EQU CYREG_PM_STBY_CFG8
coarseDAC_viDAC8__PM_STBY_MSK EQU 0x01
coarseDAC_viDAC8__STROBE EQU CYREG_DAC0_STROBE
coarseDAC_viDAC8__SW0 EQU CYREG_DAC0_SW0
coarseDAC_viDAC8__SW2 EQU CYREG_DAC0_SW2
coarseDAC_viDAC8__SW3 EQU CYREG_DAC0_SW3
coarseDAC_viDAC8__SW4 EQU CYREG_DAC0_SW4
coarseDAC_viDAC8__TR EQU CYREG_DAC0_TR
coarseDAC_viDAC8__TRIM__M1 EQU CYREG_FLSHID_CUST_TABLES_DAC0_M1
coarseDAC_viDAC8__TRIM__M2 EQU CYREG_FLSHID_CUST_TABLES_DAC0_M2
coarseDAC_viDAC8__TRIM__M3 EQU CYREG_FLSHID_CUST_TABLES_DAC0_M3
coarseDAC_viDAC8__TRIM__M4 EQU CYREG_FLSHID_CUST_TABLES_DAC0_M4
coarseDAC_viDAC8__TRIM__M5 EQU CYREG_FLSHID_CUST_TABLES_DAC0_M5
coarseDAC_viDAC8__TRIM__M6 EQU CYREG_FLSHID_CUST_TABLES_DAC0_M6
coarseDAC_viDAC8__TRIM__M7 EQU CYREG_FLSHID_CUST_TABLES_DAC0_M7
coarseDAC_viDAC8__TRIM__M8 EQU CYREG_FLSHID_CUST_TABLES_DAC0_M8
coarseDAC_viDAC8__TST EQU CYREG_DAC0_TST

/* errMonADC */
errMonADC_ADC_SAR__CLK EQU CYREG_SAR0_CLK
errMonADC_ADC_SAR__CSR0 EQU CYREG_SAR0_CSR0
errMonADC_ADC_SAR__CSR1 EQU CYREG_SAR0_CSR1
errMonADC_ADC_SAR__CSR2 EQU CYREG_SAR0_CSR2
errMonADC_ADC_SAR__CSR3 EQU CYREG_SAR0_CSR3
errMonADC_ADC_SAR__CSR4 EQU CYREG_SAR0_CSR4
errMonADC_ADC_SAR__CSR5 EQU CYREG_SAR0_CSR5
errMonADC_ADC_SAR__CSR6 EQU CYREG_SAR0_CSR6
errMonADC_ADC_SAR__PM_ACT_CFG EQU CYREG_PM_ACT_CFG11
errMonADC_ADC_SAR__PM_ACT_MSK EQU 0x01
errMonADC_ADC_SAR__PM_STBY_CFG EQU CYREG_PM_STBY_CFG11
errMonADC_ADC_SAR__PM_STBY_MSK EQU 0x01
errMonADC_ADC_SAR__SW0 EQU CYREG_SAR0_SW0
errMonADC_ADC_SAR__SW2 EQU CYREG_SAR0_SW2
errMonADC_ADC_SAR__SW3 EQU CYREG_SAR0_SW3
errMonADC_ADC_SAR__SW4 EQU CYREG_SAR0_SW4
errMonADC_ADC_SAR__SW6 EQU CYREG_SAR0_SW6
errMonADC_ADC_SAR__TR0 EQU CYREG_SAR0_TR0
errMonADC_ADC_SAR__WRK0 EQU CYREG_SAR0_WRK0
errMonADC_ADC_SAR__WRK1 EQU CYREG_SAR0_WRK1
errMonADC_IRQ__INTC_CLR_EN_REG EQU CYREG_NVIC_CLRENA0
errMonADC_IRQ__INTC_CLR_PD_REG EQU CYREG_NVIC_CLRPEND0
errMonADC_IRQ__INTC_MASK EQU 0x01
errMonADC_IRQ__INTC_NUMBER EQU 0
errMonADC_IRQ__INTC_PRIOR_NUM EQU 7
errMonADC_IRQ__INTC_PRIOR_REG EQU CYREG_NVIC_PRI_0
errMonADC_IRQ__INTC_SET_EN_REG EQU CYREG_NVIC_SETENA0
errMonADC_IRQ__INTC_SET_PD_REG EQU CYREG_NVIC_SETPEND0
errMonADC_theACLK__CFG0 EQU CYREG_CLKDIST_ACFG0_CFG0
errMonADC_theACLK__CFG1 EQU CYREG_CLKDIST_ACFG0_CFG1
errMonADC_theACLK__CFG2 EQU CYREG_CLKDIST_ACFG0_CFG2
errMonADC_theACLK__CFG2_SRC_SEL_MASK EQU 0x07
errMonADC_theACLK__CFG3 EQU CYREG_CLKDIST_ACFG0_CFG3
errMonADC_theACLK__CFG3_PHASE_DLY_MASK EQU 0x0F
errMonADC_theACLK__INDEX EQU 0x00
errMonADC_theACLK__PM_ACT_CFG EQU CYREG_PM_ACT_CFG1
errMonADC_theACLK__PM_ACT_MSK EQU 0x01
errMonADC_theACLK__PM_STBY_CFG EQU CYREG_PM_STBY_CFG1
errMonADC_theACLK__PM_STBY_MSK EQU 0x01

/* errMonPin */
errMonPin__0__INTTYPE EQU CYREG_PICU0_INTTYPE3
errMonPin__0__MASK EQU 0x08
errMonPin__0__PC EQU CYREG_PRT0_PC3
errMonPin__0__PORT EQU 0
errMonPin__0__SHIFT EQU 3
errMonPin__AG EQU CYREG_PRT0_AG
errMonPin__AMUX EQU CYREG_PRT0_AMUX
errMonPin__BIE EQU CYREG_PRT0_BIE
errMonPin__BIT_MASK EQU CYREG_PRT0_BIT_MASK
errMonPin__BYP EQU CYREG_PRT0_BYP
errMonPin__CTL EQU CYREG_PRT0_CTL
errMonPin__DM0 EQU CYREG_PRT0_DM0
errMonPin__DM1 EQU CYREG_PRT0_DM1
errMonPin__DM2 EQU CYREG_PRT0_DM2
errMonPin__DR EQU CYREG_PRT0_DR
errMonPin__INP_DIS EQU CYREG_PRT0_INP_DIS
errMonPin__INTTYPE_BASE EQU CYDEV_PICU_INTTYPE_PICU0_BASE
errMonPin__LCD_COM_SEG EQU CYREG_PRT0_LCD_COM_SEG
errMonPin__LCD_EN EQU CYREG_PRT0_LCD_EN
errMonPin__MASK EQU 0x08
errMonPin__PORT EQU 0
errMonPin__PRT EQU CYREG_PRT0_PRT
errMonPin__PRTDSI__CAPS_SEL EQU CYREG_PRT0_CAPS_SEL
errMonPin__PRTDSI__DBL_SYNC_IN EQU CYREG_PRT0_DBL_SYNC_IN
errMonPin__PRTDSI__OE_SEL0 EQU CYREG_PRT0_OE_SEL0
errMonPin__PRTDSI__OE_SEL1 EQU CYREG_PRT0_OE_SEL1
errMonPin__PRTDSI__OUT_SEL0 EQU CYREG_PRT0_OUT_SEL0
errMonPin__PRTDSI__OUT_SEL1 EQU CYREG_PRT0_OUT_SEL1
errMonPin__PRTDSI__SYNC_OUT EQU CYREG_PRT0_SYNC_OUT
errMonPin__PS EQU CYREG_PRT0_PS
errMonPin__SHIFT EQU 3
errMonPin__SLW EQU CYREG_PRT0_SLW

/* setting8V */
setting8V__0__INTTYPE EQU CYREG_PICU0_INTTYPE4
setting8V__0__MASK EQU 0x10
setting8V__0__PC EQU CYREG_PRT0_PC4
setting8V__0__PORT EQU 0
setting8V__0__SHIFT EQU 4
setting8V__AG EQU CYREG_PRT0_AG
setting8V__AMUX EQU CYREG_PRT0_AMUX
setting8V__BIE EQU CYREG_PRT0_BIE
setting8V__BIT_MASK EQU CYREG_PRT0_BIT_MASK
setting8V__BYP EQU CYREG_PRT0_BYP
setting8V__CTL EQU CYREG_PRT0_CTL
setting8V__DM0 EQU CYREG_PRT0_DM0
setting8V__DM1 EQU CYREG_PRT0_DM1
setting8V__DM2 EQU CYREG_PRT0_DM2
setting8V__DR EQU CYREG_PRT0_DR
setting8V__INP_DIS EQU CYREG_PRT0_INP_DIS
setting8V__INTTYPE_BASE EQU CYDEV_PICU_INTTYPE_PICU0_BASE
setting8V__LCD_COM_SEG EQU CYREG_PRT0_LCD_COM_SEG
setting8V__LCD_EN EQU CYREG_PRT0_LCD_EN
setting8V__MASK EQU 0x10
setting8V__PORT EQU 0
setting8V__PRT EQU CYREG_PRT0_PRT
setting8V__PRTDSI__CAPS_SEL EQU CYREG_PRT0_CAPS_SEL
setting8V__PRTDSI__DBL_SYNC_IN EQU CYREG_PRT0_DBL_SYNC_IN
setting8V__PRTDSI__OE_SEL0 EQU CYREG_PRT0_OE_SEL0
setting8V__PRTDSI__OE_SEL1 EQU CYREG_PRT0_OE_SEL1
setting8V__PRTDSI__OUT_SEL0 EQU CYREG_PRT0_OUT_SEL0
setting8V__PRTDSI__OUT_SEL1 EQU CYREG_PRT0_OUT_SEL1
setting8V__PRTDSI__SYNC_OUT EQU CYREG_PRT0_SYNC_OUT
setting8V__PS EQU CYREG_PRT0_PS
setting8V__SHIFT EQU 4
setting8V__SLW EQU CYREG_PRT0_SLW

/* fineDACOut */
fineDACOut__0__INTTYPE EQU CYREG_PICU3_INTTYPE1
fineDACOut__0__MASK EQU 0x02
fineDACOut__0__PC EQU CYREG_PRT3_PC1
fineDACOut__0__PORT EQU 3
fineDACOut__0__SHIFT EQU 1
fineDACOut__AG EQU CYREG_PRT3_AG
fineDACOut__AMUX EQU CYREG_PRT3_AMUX
fineDACOut__BIE EQU CYREG_PRT3_BIE
fineDACOut__BIT_MASK EQU CYREG_PRT3_BIT_MASK
fineDACOut__BYP EQU CYREG_PRT3_BYP
fineDACOut__CTL EQU CYREG_PRT3_CTL
fineDACOut__DM0 EQU CYREG_PRT3_DM0
fineDACOut__DM1 EQU CYREG_PRT3_DM1
fineDACOut__DM2 EQU CYREG_PRT3_DM2
fineDACOut__DR EQU CYREG_PRT3_DR
fineDACOut__INP_DIS EQU CYREG_PRT3_INP_DIS
fineDACOut__INTTYPE_BASE EQU CYDEV_PICU_INTTYPE_PICU3_BASE
fineDACOut__LCD_COM_SEG EQU CYREG_PRT3_LCD_COM_SEG
fineDACOut__LCD_EN EQU CYREG_PRT3_LCD_EN
fineDACOut__MASK EQU 0x02
fineDACOut__PORT EQU 3
fineDACOut__PRT EQU CYREG_PRT3_PRT
fineDACOut__PRTDSI__CAPS_SEL EQU CYREG_PRT3_CAPS_SEL
fineDACOut__PRTDSI__DBL_SYNC_IN EQU CYREG_PRT3_DBL_SYNC_IN
fineDACOut__PRTDSI__OE_SEL0 EQU CYREG_PRT3_OE_SEL0
fineDACOut__PRTDSI__OE_SEL1 EQU CYREG_PRT3_OE_SEL1
fineDACOut__PRTDSI__OUT_SEL0 EQU CYREG_PRT3_OUT_SEL0
fineDACOut__PRTDSI__OUT_SEL1 EQU CYREG_PRT3_OUT_SEL1
fineDACOut__PRTDSI__SYNC_OUT EQU CYREG_PRT3_SYNC_OUT
fineDACOut__PS EQU CYREG_PRT3_PS
fineDACOut__SHIFT EQU 1
fineDACOut__SLW EQU CYREG_PRT3_SLW

/* greenLight */
greenLight__0__INTTYPE EQU CYREG_PICU5_INTTYPE7
greenLight__0__MASK EQU 0x80
greenLight__0__PC EQU CYREG_PRT5_PC7
greenLight__0__PORT EQU 5
greenLight__0__SHIFT EQU 7
greenLight__AG EQU CYREG_PRT5_AG
greenLight__AMUX EQU CYREG_PRT5_AMUX
greenLight__BIE EQU CYREG_PRT5_BIE
greenLight__BIT_MASK EQU CYREG_PRT5_BIT_MASK
greenLight__BYP EQU CYREG_PRT5_BYP
greenLight__CTL EQU CYREG_PRT5_CTL
greenLight__DM0 EQU CYREG_PRT5_DM0
greenLight__DM1 EQU CYREG_PRT5_DM1
greenLight__DM2 EQU CYREG_PRT5_DM2
greenLight__DR EQU CYREG_PRT5_DR
greenLight__INP_DIS EQU CYREG_PRT5_INP_DIS
greenLight__INTTYPE_BASE EQU CYDEV_PICU_INTTYPE_PICU5_BASE
greenLight__LCD_COM_SEG EQU CYREG_PRT5_LCD_COM_SEG
greenLight__LCD_EN EQU CYREG_PRT5_LCD_EN
greenLight__MASK EQU 0x80
greenLight__PORT EQU 5
greenLight__PRT EQU CYREG_PRT5_PRT
greenLight__PRTDSI__CAPS_SEL EQU CYREG_PRT5_CAPS_SEL
greenLight__PRTDSI__DBL_SYNC_IN EQU CYREG_PRT5_DBL_SYNC_IN
greenLight__PRTDSI__OE_SEL0 EQU CYREG_PRT5_OE_SEL0
greenLight__PRTDSI__OE_SEL1 EQU CYREG_PRT5_OE_SEL1
greenLight__PRTDSI__OUT_SEL0 EQU CYREG_PRT5_OUT_SEL0
greenLight__PRTDSI__OUT_SEL1 EQU CYREG_PRT5_OUT_SEL1
greenLight__PRTDSI__SYNC_OUT EQU CYREG_PRT5_SYNC_OUT
greenLight__PS EQU CYREG_PRT5_PS
greenLight__SHIFT EQU 7
greenLight__SLW EQU CYREG_PRT5_SLW

/* setting22V */
setting22V__0__INTTYPE EQU CYREG_PICU0_INTTYPE2
setting22V__0__MASK EQU 0x04
setting22V__0__PC EQU CYREG_PRT0_PC2
setting22V__0__PORT EQU 0
setting22V__0__SHIFT EQU 2
setting22V__AG EQU CYREG_PRT0_AG
setting22V__AMUX EQU CYREG_PRT0_AMUX
setting22V__BIE EQU CYREG_PRT0_BIE
setting22V__BIT_MASK EQU CYREG_PRT0_BIT_MASK
setting22V__BYP EQU CYREG_PRT0_BYP
setting22V__CTL EQU CYREG_PRT0_CTL
setting22V__DM0 EQU CYREG_PRT0_DM0
setting22V__DM1 EQU CYREG_PRT0_DM1
setting22V__DM2 EQU CYREG_PRT0_DM2
setting22V__DR EQU CYREG_PRT0_DR
setting22V__INP_DIS EQU CYREG_PRT0_INP_DIS
setting22V__INTTYPE_BASE EQU CYDEV_PICU_INTTYPE_PICU0_BASE
setting22V__LCD_COM_SEG EQU CYREG_PRT0_LCD_COM_SEG
setting22V__LCD_EN EQU CYREG_PRT0_LCD_EN
setting22V__MASK EQU 0x04
setting22V__PORT EQU 0
setting22V__PRT EQU CYREG_PRT0_PRT
setting22V__PRTDSI__CAPS_SEL EQU CYREG_PRT0_CAPS_SEL
setting22V__PRTDSI__DBL_SYNC_IN EQU CYREG_PRT0_DBL_SYNC_IN
setting22V__PRTDSI__OE_SEL0 EQU CYREG_PRT0_OE_SEL0
setting22V__PRTDSI__OE_SEL1 EQU CYREG_PRT0_OE_SEL1
setting22V__PRTDSI__OUT_SEL0 EQU CYREG_PRT0_OUT_SEL0
setting22V__PRTDSI__OUT_SEL1 EQU CYREG_PRT0_OUT_SEL1
setting22V__PRTDSI__SYNC_OUT EQU CYREG_PRT0_SYNC_OUT
setting22V__PS EQU CYREG_PRT0_PS
setting22V__SHIFT EQU 2
setting22V__SLW EQU CYREG_PRT0_SLW

/* setting28V */
setting28V__0__INTTYPE EQU CYREG_PICU0_INTTYPE0
setting28V__0__MASK EQU 0x01
setting28V__0__PC EQU CYREG_PRT0_PC0
setting28V__0__PORT EQU 0
setting28V__0__SHIFT EQU 0
setting28V__AG EQU CYREG_PRT0_AG
setting28V__AMUX EQU CYREG_PRT0_AMUX
setting28V__BIE EQU CYREG_PRT0_BIE
setting28V__BIT_MASK EQU CYREG_PRT0_BIT_MASK
setting28V__BYP EQU CYREG_PRT0_BYP
setting28V__CTL EQU CYREG_PRT0_CTL
setting28V__DM0 EQU CYREG_PRT0_DM0
setting28V__DM1 EQU CYREG_PRT0_DM1
setting28V__DM2 EQU CYREG_PRT0_DM2
setting28V__DR EQU CYREG_PRT0_DR
setting28V__INP_DIS EQU CYREG_PRT0_INP_DIS
setting28V__INTTYPE_BASE EQU CYDEV_PICU_INTTYPE_PICU0_BASE
setting28V__LCD_COM_SEG EQU CYREG_PRT0_LCD_COM_SEG
setting28V__LCD_EN EQU CYREG_PRT0_LCD_EN
setting28V__MASK EQU 0x01
setting28V__PORT EQU 0
setting28V__PRT EQU CYREG_PRT0_PRT
setting28V__PRTDSI__CAPS_SEL EQU CYREG_PRT0_CAPS_SEL
setting28V__PRTDSI__DBL_SYNC_IN EQU CYREG_PRT0_DBL_SYNC_IN
setting28V__PRTDSI__OE_SEL0 EQU CYREG_PRT0_OE_SEL0
setting28V__PRTDSI__OE_SEL1 EQU CYREG_PRT0_OE_SEL1
setting28V__PRTDSI__OUT_SEL0 EQU CYREG_PRT0_OUT_SEL0
setting28V__PRTDSI__OUT_SEL1 EQU CYREG_PRT0_OUT_SEL1
setting28V__PRTDSI__SYNC_OUT EQU CYREG_PRT0_SYNC_OUT
setting28V__PS EQU CYREG_PRT0_PS
setting28V__SHIFT EQU 0
setting28V__SLW EQU CYREG_PRT0_SLW

/* orangeLight */
orangeLight__0__INTTYPE EQU CYREG_PICU5_INTTYPE3
orangeLight__0__MASK EQU 0x08
orangeLight__0__PC EQU CYREG_PRT5_PC3
orangeLight__0__PORT EQU 5
orangeLight__0__SHIFT EQU 3
orangeLight__AG EQU CYREG_PRT5_AG
orangeLight__AMUX EQU CYREG_PRT5_AMUX
orangeLight__BIE EQU CYREG_PRT5_BIE
orangeLight__BIT_MASK EQU CYREG_PRT5_BIT_MASK
orangeLight__BYP EQU CYREG_PRT5_BYP
orangeLight__CTL EQU CYREG_PRT5_CTL
orangeLight__DM0 EQU CYREG_PRT5_DM0
orangeLight__DM1 EQU CYREG_PRT5_DM1
orangeLight__DM2 EQU CYREG_PRT5_DM2
orangeLight__DR EQU CYREG_PRT5_DR
orangeLight__INP_DIS EQU CYREG_PRT5_INP_DIS
orangeLight__INTTYPE_BASE EQU CYDEV_PICU_INTTYPE_PICU5_BASE
orangeLight__LCD_COM_SEG EQU CYREG_PRT5_LCD_COM_SEG
orangeLight__LCD_EN EQU CYREG_PRT5_LCD_EN
orangeLight__MASK EQU 0x08
orangeLight__PORT EQU 5
orangeLight__PRT EQU CYREG_PRT5_PRT
orangeLight__PRTDSI__CAPS_SEL EQU CYREG_PRT5_CAPS_SEL
orangeLight__PRTDSI__DBL_SYNC_IN EQU CYREG_PRT5_DBL_SYNC_IN
orangeLight__PRTDSI__OE_SEL0 EQU CYREG_PRT5_OE_SEL0
orangeLight__PRTDSI__OE_SEL1 EQU CYREG_PRT5_OE_SEL1
orangeLight__PRTDSI__OUT_SEL0 EQU CYREG_PRT5_OUT_SEL0
orangeLight__PRTDSI__OUT_SEL1 EQU CYREG_PRT5_OUT_SEL1
orangeLight__PRTDSI__SYNC_OUT EQU CYREG_PRT5_SYNC_OUT
orangeLight__PS EQU CYREG_PRT5_PS
orangeLight__SHIFT EQU 3
orangeLight__SLW EQU CYREG_PRT5_SLW

/* tempTrigger */
tempTrigger__0__INTTYPE EQU CYREG_PICU5_INTTYPE0
tempTrigger__0__MASK EQU 0x01
tempTrigger__0__PC EQU CYREG_PRT5_PC0
tempTrigger__0__PORT EQU 5
tempTrigger__0__SHIFT EQU 0
tempTrigger__AG EQU CYREG_PRT5_AG
tempTrigger__AMUX EQU CYREG_PRT5_AMUX
tempTrigger__BIE EQU CYREG_PRT5_BIE
tempTrigger__BIT_MASK EQU CYREG_PRT5_BIT_MASK
tempTrigger__BYP EQU CYREG_PRT5_BYP
tempTrigger__CTL EQU CYREG_PRT5_CTL
tempTrigger__DM0 EQU CYREG_PRT5_DM0
tempTrigger__DM1 EQU CYREG_PRT5_DM1
tempTrigger__DM2 EQU CYREG_PRT5_DM2
tempTrigger__DR EQU CYREG_PRT5_DR
tempTrigger__INP_DIS EQU CYREG_PRT5_INP_DIS
tempTrigger__INTTYPE_BASE EQU CYDEV_PICU_INTTYPE_PICU5_BASE
tempTrigger__LCD_COM_SEG EQU CYREG_PRT5_LCD_COM_SEG
tempTrigger__LCD_EN EQU CYREG_PRT5_LCD_EN
tempTrigger__MASK EQU 0x01
tempTrigger__PORT EQU 5
tempTrigger__PRT EQU CYREG_PRT5_PRT
tempTrigger__PRTDSI__CAPS_SEL EQU CYREG_PRT5_CAPS_SEL
tempTrigger__PRTDSI__DBL_SYNC_IN EQU CYREG_PRT5_DBL_SYNC_IN
tempTrigger__PRTDSI__OE_SEL0 EQU CYREG_PRT5_OE_SEL0
tempTrigger__PRTDSI__OE_SEL1 EQU CYREG_PRT5_OE_SEL1
tempTrigger__PRTDSI__OUT_SEL0 EQU CYREG_PRT5_OUT_SEL0
tempTrigger__PRTDSI__OUT_SEL1 EQU CYREG_PRT5_OUT_SEL1
tempTrigger__PRTDSI__SYNC_OUT EQU CYREG_PRT5_SYNC_OUT
tempTrigger__PS EQU CYREG_PRT5_PS
tempTrigger__SHIFT EQU 0
tempTrigger__SLW EQU CYREG_PRT5_SLW

/* yellowLight */
yellowLight__0__INTTYPE EQU CYREG_PICU5_INTTYPE5
yellowLight__0__MASK EQU 0x20
yellowLight__0__PC EQU CYREG_PRT5_PC5
yellowLight__0__PORT EQU 5
yellowLight__0__SHIFT EQU 5
yellowLight__AG EQU CYREG_PRT5_AG
yellowLight__AMUX EQU CYREG_PRT5_AMUX
yellowLight__BIE EQU CYREG_PRT5_BIE
yellowLight__BIT_MASK EQU CYREG_PRT5_BIT_MASK
yellowLight__BYP EQU CYREG_PRT5_BYP
yellowLight__CTL EQU CYREG_PRT5_CTL
yellowLight__DM0 EQU CYREG_PRT5_DM0
yellowLight__DM1 EQU CYREG_PRT5_DM1
yellowLight__DM2 EQU CYREG_PRT5_DM2
yellowLight__DR EQU CYREG_PRT5_DR
yellowLight__INP_DIS EQU CYREG_PRT5_INP_DIS
yellowLight__INTTYPE_BASE EQU CYDEV_PICU_INTTYPE_PICU5_BASE
yellowLight__LCD_COM_SEG EQU CYREG_PRT5_LCD_COM_SEG
yellowLight__LCD_EN EQU CYREG_PRT5_LCD_EN
yellowLight__MASK EQU 0x20
yellowLight__PORT EQU 5
yellowLight__PRT EQU CYREG_PRT5_PRT
yellowLight__PRTDSI__CAPS_SEL EQU CYREG_PRT5_CAPS_SEL
yellowLight__PRTDSI__DBL_SYNC_IN EQU CYREG_PRT5_DBL_SYNC_IN
yellowLight__PRTDSI__OE_SEL0 EQU CYREG_PRT5_OE_SEL0
yellowLight__PRTDSI__OE_SEL1 EQU CYREG_PRT5_OE_SEL1
yellowLight__PRTDSI__OUT_SEL0 EQU CYREG_PRT5_OUT_SEL0
yellowLight__PRTDSI__OUT_SEL1 EQU CYREG_PRT5_OUT_SEL1
yellowLight__PRTDSI__SYNC_OUT EQU CYREG_PRT5_SYNC_OUT
yellowLight__PS EQU CYREG_PRT5_PS
yellowLight__SHIFT EQU 5
yellowLight__SLW EQU CYREG_PRT5_SLW

/* SW_Tx_UART_1 */
SW_Tx_UART_1_tx__0__INTTYPE EQU CYREG_PICU2_INTTYPE1
SW_Tx_UART_1_tx__0__MASK EQU 0x02
SW_Tx_UART_1_tx__0__PC EQU CYREG_PRT2_PC1
SW_Tx_UART_1_tx__0__PORT EQU 2
SW_Tx_UART_1_tx__0__SHIFT EQU 1
SW_Tx_UART_1_tx__AG EQU CYREG_PRT2_AG
SW_Tx_UART_1_tx__AMUX EQU CYREG_PRT2_AMUX
SW_Tx_UART_1_tx__BIE EQU CYREG_PRT2_BIE
SW_Tx_UART_1_tx__BIT_MASK EQU CYREG_PRT2_BIT_MASK
SW_Tx_UART_1_tx__BYP EQU CYREG_PRT2_BYP
SW_Tx_UART_1_tx__CTL EQU CYREG_PRT2_CTL
SW_Tx_UART_1_tx__DM0 EQU CYREG_PRT2_DM0
SW_Tx_UART_1_tx__DM1 EQU CYREG_PRT2_DM1
SW_Tx_UART_1_tx__DM2 EQU CYREG_PRT2_DM2
SW_Tx_UART_1_tx__DR EQU CYREG_PRT2_DR
SW_Tx_UART_1_tx__INP_DIS EQU CYREG_PRT2_INP_DIS
SW_Tx_UART_1_tx__INTTYPE_BASE EQU CYDEV_PICU_INTTYPE_PICU2_BASE
SW_Tx_UART_1_tx__LCD_COM_SEG EQU CYREG_PRT2_LCD_COM_SEG
SW_Tx_UART_1_tx__LCD_EN EQU CYREG_PRT2_LCD_EN
SW_Tx_UART_1_tx__MASK EQU 0x02
SW_Tx_UART_1_tx__PORT EQU 2
SW_Tx_UART_1_tx__PRT EQU CYREG_PRT2_PRT
SW_Tx_UART_1_tx__PRTDSI__CAPS_SEL EQU CYREG_PRT2_CAPS_SEL
SW_Tx_UART_1_tx__PRTDSI__DBL_SYNC_IN EQU CYREG_PRT2_DBL_SYNC_IN
SW_Tx_UART_1_tx__PRTDSI__OE_SEL0 EQU CYREG_PRT2_OE_SEL0
SW_Tx_UART_1_tx__PRTDSI__OE_SEL1 EQU CYREG_PRT2_OE_SEL1
SW_Tx_UART_1_tx__PRTDSI__OUT_SEL0 EQU CYREG_PRT2_OUT_SEL0
SW_Tx_UART_1_tx__PRTDSI__OUT_SEL1 EQU CYREG_PRT2_OUT_SEL1
SW_Tx_UART_1_tx__PRTDSI__SYNC_OUT EQU CYREG_PRT2_SYNC_OUT
SW_Tx_UART_1_tx__PS EQU CYREG_PRT2_PS
SW_Tx_UART_1_tx__SHIFT EQU 1
SW_Tx_UART_1_tx__SLW EQU CYREG_PRT2_SLW

/* blockLockPin */
blockLockPin__0__INTTYPE EQU CYREG_PICU3_INTTYPE0
blockLockPin__0__MASK EQU 0x01
blockLockPin__0__PC EQU CYREG_PRT3_PC0
blockLockPin__0__PORT EQU 3
blockLockPin__0__SHIFT EQU 0
blockLockPin__AG EQU CYREG_PRT3_AG
blockLockPin__AMUX EQU CYREG_PRT3_AMUX
blockLockPin__BIE EQU CYREG_PRT3_BIE
blockLockPin__BIT_MASK EQU CYREG_PRT3_BIT_MASK
blockLockPin__BYP EQU CYREG_PRT3_BYP
blockLockPin__CTL EQU CYREG_PRT3_CTL
blockLockPin__DM0 EQU CYREG_PRT3_DM0
blockLockPin__DM1 EQU CYREG_PRT3_DM1
blockLockPin__DM2 EQU CYREG_PRT3_DM2
blockLockPin__DR EQU CYREG_PRT3_DR
blockLockPin__INP_DIS EQU CYREG_PRT3_INP_DIS
blockLockPin__INTTYPE_BASE EQU CYDEV_PICU_INTTYPE_PICU3_BASE
blockLockPin__LCD_COM_SEG EQU CYREG_PRT3_LCD_COM_SEG
blockLockPin__LCD_EN EQU CYREG_PRT3_LCD_EN
blockLockPin__MASK EQU 0x01
blockLockPin__PORT EQU 3
blockLockPin__PRT EQU CYREG_PRT3_PRT
blockLockPin__PRTDSI__CAPS_SEL EQU CYREG_PRT3_CAPS_SEL
blockLockPin__PRTDSI__DBL_SYNC_IN EQU CYREG_PRT3_DBL_SYNC_IN
blockLockPin__PRTDSI__OE_SEL0 EQU CYREG_PRT3_OE_SEL0
blockLockPin__PRTDSI__OE_SEL1 EQU CYREG_PRT3_OE_SEL1
blockLockPin__PRTDSI__OUT_SEL0 EQU CYREG_PRT3_OUT_SEL0
blockLockPin__PRTDSI__OUT_SEL1 EQU CYREG_PRT3_OUT_SEL1
blockLockPin__PRTDSI__SYNC_OUT EQU CYREG_PRT3_SYNC_OUT
blockLockPin__PS EQU CYREG_PRT3_PS
blockLockPin__SHIFT EQU 0
blockLockPin__SLW EQU CYREG_PRT3_SLW

/* calibratePin */
calibratePin__0__INTTYPE EQU CYREG_PICU5_INTTYPE2
calibratePin__0__MASK EQU 0x04
calibratePin__0__PC EQU CYREG_PRT5_PC2
calibratePin__0__PORT EQU 5
calibratePin__0__SHIFT EQU 2
calibratePin__AG EQU CYREG_PRT5_AG
calibratePin__AMUX EQU CYREG_PRT5_AMUX
calibratePin__BIE EQU CYREG_PRT5_BIE
calibratePin__BIT_MASK EQU CYREG_PRT5_BIT_MASK
calibratePin__BYP EQU CYREG_PRT5_BYP
calibratePin__CTL EQU CYREG_PRT5_CTL
calibratePin__DM0 EQU CYREG_PRT5_DM0
calibratePin__DM1 EQU CYREG_PRT5_DM1
calibratePin__DM2 EQU CYREG_PRT5_DM2
calibratePin__DR EQU CYREG_PRT5_DR
calibratePin__INP_DIS EQU CYREG_PRT5_INP_DIS
calibratePin__INTTYPE_BASE EQU CYDEV_PICU_INTTYPE_PICU5_BASE
calibratePin__LCD_COM_SEG EQU CYREG_PRT5_LCD_COM_SEG
calibratePin__LCD_EN EQU CYREG_PRT5_LCD_EN
calibratePin__MASK EQU 0x04
calibratePin__PORT EQU 5
calibratePin__PRT EQU CYREG_PRT5_PRT
calibratePin__PRTDSI__CAPS_SEL EQU CYREG_PRT5_CAPS_SEL
calibratePin__PRTDSI__DBL_SYNC_IN EQU CYREG_PRT5_DBL_SYNC_IN
calibratePin__PRTDSI__OE_SEL0 EQU CYREG_PRT5_OE_SEL0
calibratePin__PRTDSI__OE_SEL1 EQU CYREG_PRT5_OE_SEL1
calibratePin__PRTDSI__OUT_SEL0 EQU CYREG_PRT5_OUT_SEL0
calibratePin__PRTDSI__OUT_SEL1 EQU CYREG_PRT5_OUT_SEL1
calibratePin__PRTDSI__SYNC_OUT EQU CYREG_PRT5_SYNC_OUT
calibratePin__PS EQU CYREG_PRT5_PS
calibratePin__SHIFT EQU 2
calibratePin__SLW EQU CYREG_PRT5_SLW

/* coarseDACOut */
coarseDACOut__0__INTTYPE EQU CYREG_PICU0_INTTYPE6
coarseDACOut__0__MASK EQU 0x40
coarseDACOut__0__PC EQU CYREG_PRT0_PC6
coarseDACOut__0__PORT EQU 0
coarseDACOut__0__SHIFT EQU 6
coarseDACOut__AG EQU CYREG_PRT0_AG
coarseDACOut__AMUX EQU CYREG_PRT0_AMUX
coarseDACOut__BIE EQU CYREG_PRT0_BIE
coarseDACOut__BIT_MASK EQU CYREG_PRT0_BIT_MASK
coarseDACOut__BYP EQU CYREG_PRT0_BYP
coarseDACOut__CTL EQU CYREG_PRT0_CTL
coarseDACOut__DM0 EQU CYREG_PRT0_DM0
coarseDACOut__DM1 EQU CYREG_PRT0_DM1
coarseDACOut__DM2 EQU CYREG_PRT0_DM2
coarseDACOut__DR EQU CYREG_PRT0_DR
coarseDACOut__INP_DIS EQU CYREG_PRT0_INP_DIS
coarseDACOut__INTTYPE_BASE EQU CYDEV_PICU_INTTYPE_PICU0_BASE
coarseDACOut__LCD_COM_SEG EQU CYREG_PRT0_LCD_COM_SEG
coarseDACOut__LCD_EN EQU CYREG_PRT0_LCD_EN
coarseDACOut__MASK EQU 0x40
coarseDACOut__PORT EQU 0
coarseDACOut__PRT EQU CYREG_PRT0_PRT
coarseDACOut__PRTDSI__CAPS_SEL EQU CYREG_PRT0_CAPS_SEL
coarseDACOut__PRTDSI__DBL_SYNC_IN EQU CYREG_PRT0_DBL_SYNC_IN
coarseDACOut__PRTDSI__OE_SEL0 EQU CYREG_PRT0_OE_SEL0
coarseDACOut__PRTDSI__OE_SEL1 EQU CYREG_PRT0_OE_SEL1
coarseDACOut__PRTDSI__OUT_SEL0 EQU CYREG_PRT0_OUT_SEL0
coarseDACOut__PRTDSI__OUT_SEL1 EQU CYREG_PRT0_OUT_SEL1
coarseDACOut__PRTDSI__SYNC_OUT EQU CYREG_PRT0_SYNC_OUT
coarseDACOut__PS EQU CYREG_PRT0_PS
coarseDACOut__SHIFT EQU 6
coarseDACOut__SLW EQU CYREG_PRT0_SLW

/* sampleErrorMonitor */
sampleErrorMonitor__0__INTTYPE EQU CYREG_PICU5_INTTYPE4
sampleErrorMonitor__0__MASK EQU 0x10
sampleErrorMonitor__0__PC EQU CYREG_PRT5_PC4
sampleErrorMonitor__0__PORT EQU 5
sampleErrorMonitor__0__SHIFT EQU 4
sampleErrorMonitor__AG EQU CYREG_PRT5_AG
sampleErrorMonitor__AMUX EQU CYREG_PRT5_AMUX
sampleErrorMonitor__BIE EQU CYREG_PRT5_BIE
sampleErrorMonitor__BIT_MASK EQU CYREG_PRT5_BIT_MASK
sampleErrorMonitor__BYP EQU CYREG_PRT5_BYP
sampleErrorMonitor__CTL EQU CYREG_PRT5_CTL
sampleErrorMonitor__DM0 EQU CYREG_PRT5_DM0
sampleErrorMonitor__DM1 EQU CYREG_PRT5_DM1
sampleErrorMonitor__DM2 EQU CYREG_PRT5_DM2
sampleErrorMonitor__DR EQU CYREG_PRT5_DR
sampleErrorMonitor__INP_DIS EQU CYREG_PRT5_INP_DIS
sampleErrorMonitor__INTTYPE_BASE EQU CYDEV_PICU_INTTYPE_PICU5_BASE
sampleErrorMonitor__LCD_COM_SEG EQU CYREG_PRT5_LCD_COM_SEG
sampleErrorMonitor__LCD_EN EQU CYREG_PRT5_LCD_EN
sampleErrorMonitor__MASK EQU 0x10
sampleErrorMonitor__PORT EQU 5
sampleErrorMonitor__PRT EQU CYREG_PRT5_PRT
sampleErrorMonitor__PRTDSI__CAPS_SEL EQU CYREG_PRT5_CAPS_SEL
sampleErrorMonitor__PRTDSI__DBL_SYNC_IN EQU CYREG_PRT5_DBL_SYNC_IN
sampleErrorMonitor__PRTDSI__OE_SEL0 EQU CYREG_PRT5_OE_SEL0
sampleErrorMonitor__PRTDSI__OE_SEL1 EQU CYREG_PRT5_OE_SEL1
sampleErrorMonitor__PRTDSI__OUT_SEL0 EQU CYREG_PRT5_OUT_SEL0
sampleErrorMonitor__PRTDSI__OUT_SEL1 EQU CYREG_PRT5_OUT_SEL1
sampleErrorMonitor__PRTDSI__SYNC_OUT EQU CYREG_PRT5_SYNC_OUT
sampleErrorMonitor__PS EQU CYREG_PRT5_PS
sampleErrorMonitor__SHIFT EQU 4
sampleErrorMonitor__SLW EQU CYREG_PRT5_SLW

/* Miscellaneous */
BCLK__BUS_CLK__HZ EQU 24000000
BCLK__BUS_CLK__KHZ EQU 24000
BCLK__BUS_CLK__MHZ EQU 24
CYDEV_CHIP_DIE_LEOPARD EQU 1
CYDEV_CHIP_DIE_PSOC4A EQU 18
CYDEV_CHIP_DIE_PSOC5LP EQU 2
CYDEV_CHIP_DIE_PSOC5TM EQU 3
CYDEV_CHIP_DIE_TMA4 EQU 4
CYDEV_CHIP_DIE_UNKNOWN EQU 0
CYDEV_CHIP_FAMILY_FM0P EQU 5
CYDEV_CHIP_FAMILY_FM3 EQU 6
CYDEV_CHIP_FAMILY_FM4 EQU 7
CYDEV_CHIP_FAMILY_PSOC3 EQU 1
CYDEV_CHIP_FAMILY_PSOC4 EQU 2
CYDEV_CHIP_FAMILY_PSOC5 EQU 3
CYDEV_CHIP_FAMILY_PSOC6 EQU 4
CYDEV_CHIP_FAMILY_UNKNOWN EQU 0
CYDEV_CHIP_FAMILY_USED EQU CYDEV_CHIP_FAMILY_PSOC5
CYDEV_CHIP_JTAG_ID EQU 0x2E123069
CYDEV_CHIP_MEMBER_3A EQU 1
CYDEV_CHIP_MEMBER_4A EQU 18
CYDEV_CHIP_MEMBER_4D EQU 13
CYDEV_CHIP_MEMBER_4E EQU 6
CYDEV_CHIP_MEMBER_4F EQU 19
CYDEV_CHIP_MEMBER_4G EQU 4
CYDEV_CHIP_MEMBER_4H EQU 17
CYDEV_CHIP_MEMBER_4I EQU 23
CYDEV_CHIP_MEMBER_4J EQU 14
CYDEV_CHIP_MEMBER_4K EQU 15
CYDEV_CHIP_MEMBER_4L EQU 22
CYDEV_CHIP_MEMBER_4M EQU 21
CYDEV_CHIP_MEMBER_4N EQU 10
CYDEV_CHIP_MEMBER_4O EQU 7
CYDEV_CHIP_MEMBER_4P EQU 20
CYDEV_CHIP_MEMBER_4Q EQU 12
CYDEV_CHIP_MEMBER_4R EQU 8
CYDEV_CHIP_MEMBER_4S EQU 11
CYDEV_CHIP_MEMBER_4T EQU 9
CYDEV_CHIP_MEMBER_4U EQU 5
CYDEV_CHIP_MEMBER_4V EQU 16
CYDEV_CHIP_MEMBER_5A EQU 3
CYDEV_CHIP_MEMBER_5B EQU 2
CYDEV_CHIP_MEMBER_6A EQU 24
CYDEV_CHIP_MEMBER_FM3 EQU 28
CYDEV_CHIP_MEMBER_FM4 EQU 29
CYDEV_CHIP_MEMBER_PDL_FM0P_TYPE1 EQU 25
CYDEV_CHIP_MEMBER_PDL_FM0P_TYPE2 EQU 26
CYDEV_CHIP_MEMBER_PDL_FM0P_TYPE3 EQU 27
CYDEV_CHIP_MEMBER_UNKNOWN EQU 0
CYDEV_CHIP_MEMBER_USED EQU CYDEV_CHIP_MEMBER_5B
CYDEV_CHIP_DIE_EXPECT EQU CYDEV_CHIP_MEMBER_USED
CYDEV_CHIP_DIE_ACTUAL EQU CYDEV_CHIP_DIE_EXPECT
CYDEV_CHIP_REV_LEOPARD_ES1 EQU 0
CYDEV_CHIP_REV_LEOPARD_ES2 EQU 1
CYDEV_CHIP_REV_LEOPARD_ES3 EQU 3
CYDEV_CHIP_REV_LEOPARD_PRODUCTION EQU 3
CYDEV_CHIP_REV_PSOC4A_ES0 EQU 17
CYDEV_CHIP_REV_PSOC4A_PRODUCTION EQU 17
CYDEV_CHIP_REV_PSOC5LP_ES0 EQU 0
CYDEV_CHIP_REV_PSOC5LP_PRODUCTION EQU 0
CYDEV_CHIP_REV_PSOC5TM_ES0 EQU 0
CYDEV_CHIP_REV_PSOC5TM_ES1 EQU 1
CYDEV_CHIP_REV_PSOC5TM_PRODUCTION EQU 1
CYDEV_CHIP_REV_TMA4_ES EQU 17
CYDEV_CHIP_REV_TMA4_ES2 EQU 33
CYDEV_CHIP_REV_TMA4_PRODUCTION EQU 17
CYDEV_CHIP_REVISION_3A_ES1 EQU 0
CYDEV_CHIP_REVISION_3A_ES2 EQU 1
CYDEV_CHIP_REVISION_3A_ES3 EQU 3
CYDEV_CHIP_REVISION_3A_PRODUCTION EQU 3
CYDEV_CHIP_REVISION_4A_ES0 EQU 17
CYDEV_CHIP_REVISION_4A_PRODUCTION EQU 17
CYDEV_CHIP_REVISION_4D_PRODUCTION EQU 0
CYDEV_CHIP_REVISION_4E_CCG2_NO_USBPD EQU 0
CYDEV_CHIP_REVISION_4E_PRODUCTION EQU 0
CYDEV_CHIP_REVISION_4F_PRODUCTION EQU 0
CYDEV_CHIP_REVISION_4F_PRODUCTION_256DMA EQU 0
CYDEV_CHIP_REVISION_4F_PRODUCTION_256K EQU 0
CYDEV_CHIP_REVISION_4G_ES EQU 17
CYDEV_CHIP_REVISION_4G_ES2 EQU 33
CYDEV_CHIP_REVISION_4G_PRODUCTION EQU 17
CYDEV_CHIP_REVISION_4H_PRODUCTION EQU 0
CYDEV_CHIP_REVISION_4I_PRODUCTION EQU 0
CYDEV_CHIP_REVISION_4J_PRODUCTION EQU 0
CYDEV_CHIP_REVISION_4K_PRODUCTION EQU 0
CYDEV_CHIP_REVISION_4L_PRODUCTION EQU 0
CYDEV_CHIP_REVISION_4M_PRODUCTION EQU 0
CYDEV_CHIP_REVISION_4N_PRODUCTION EQU 0
CYDEV_CHIP_REVISION_4O_PRODUCTION EQU 0
CYDEV_CHIP_REVISION_4P_PRODUCTION EQU 0
CYDEV_CHIP_REVISION_4Q_PRODUCTION EQU 0
CYDEV_CHIP_REVISION_4R_PRODUCTION EQU 0
CYDEV_CHIP_REVISION_4S_PRODUCTION EQU 0
CYDEV_CHIP_REVISION_4T_PRODUCTION EQU 0
CYDEV_CHIP_REVISION_4U_PRODUCTION EQU 0
CYDEV_CHIP_REVISION_4V_PRODUCTION EQU 0
CYDEV_CHIP_REVISION_5A_ES0 EQU 0
CYDEV_CHIP_REVISION_5A_ES1 EQU 1
CYDEV_CHIP_REVISION_5A_PRODUCTION EQU 1
CYDEV_CHIP_REVISION_5B_ES0 EQU 0
CYDEV_CHIP_REVISION_5B_PRODUCTION EQU 0
CYDEV_CHIP_REVISION_6A_ES EQU 17
CYDEV_CHIP_REVISION_6A_NO_UDB EQU 33
CYDEV_CHIP_REVISION_6A_PRODUCTION EQU 33
CYDEV_CHIP_REVISION_FM3_PRODUCTION EQU 0
CYDEV_CHIP_REVISION_FM4_PRODUCTION EQU 0
CYDEV_CHIP_REVISION_PDL_FM0P_TYPE1_PRODUCTION EQU 0
CYDEV_CHIP_REVISION_PDL_FM0P_TYPE2_PRODUCTION EQU 0
CYDEV_CHIP_REVISION_PDL_FM0P_TYPE3_PRODUCTION EQU 0
CYDEV_CHIP_REVISION_USED EQU CYDEV_CHIP_REVISION_5B_PRODUCTION
CYDEV_CHIP_REV_EXPECT EQU CYDEV_CHIP_REVISION_USED
CYDEV_CONFIG_FASTBOOT_ENABLED EQU 1
CYDEV_CONFIG_UNUSED_IO_AllowButWarn EQU 0
CYDEV_CONFIG_UNUSED_IO EQU CYDEV_CONFIG_UNUSED_IO_AllowButWarn
CYDEV_CONFIG_UNUSED_IO_AllowWithInfo EQU 1
CYDEV_CONFIG_UNUSED_IO_Disallowed EQU 2
CYDEV_CONFIGURATION_COMPRESSED EQU 1
CYDEV_CONFIGURATION_DMA EQU 0
CYDEV_CONFIGURATION_ECC EQU 1
CYDEV_CONFIGURATION_IMOENABLED EQU CYDEV_CONFIG_FASTBOOT_ENABLED
CYDEV_CONFIGURATION_MODE_COMPRESSED EQU 0
CYDEV_CONFIGURATION_MODE EQU CYDEV_CONFIGURATION_MODE_COMPRESSED
CYDEV_CONFIGURATION_MODE_DMA EQU 2
CYDEV_CONFIGURATION_MODE_UNCOMPRESSED EQU 1
CYDEV_DEBUG_ENABLE_MASK EQU 0x20
CYDEV_DEBUG_ENABLE_REGISTER EQU CYREG_MLOGIC_DEBUG
CYDEV_DEBUGGING_DPS_Disable EQU 3
CYDEV_DEBUGGING_DPS_JTAG_4 EQU 1
CYDEV_DEBUGGING_DPS_JTAG_5 EQU 0
CYDEV_DEBUGGING_DPS_SWD EQU 2
CYDEV_DEBUGGING_DPS_SWD_SWV EQU 6
CYDEV_DEBUGGING_DPS EQU CYDEV_DEBUGGING_DPS_SWD_SWV
CYDEV_DEBUGGING_ENABLE EQU 1
CYDEV_DEBUGGING_XRES EQU 0
CYDEV_DMA_CHANNELS_AVAILABLE EQU 24
CYDEV_ECC_ENABLE EQU 0
CYDEV_HEAP_SIZE EQU 0x0200
CYDEV_INSTRUCT_CACHE_ENABLED EQU 1
CYDEV_INTR_RISING EQU 0x00000001
CYDEV_IS_EXPORTING_CODE EQU 0
CYDEV_IS_IMPORTING_CODE EQU 0
CYDEV_PROJ_TYPE EQU 0
CYDEV_PROJ_TYPE_BOOTLOADER EQU 1
CYDEV_PROJ_TYPE_LAUNCHER EQU 5
CYDEV_PROJ_TYPE_LOADABLE EQU 2
CYDEV_PROJ_TYPE_LOADABLEANDBOOTLOADER EQU 4
CYDEV_PROJ_TYPE_MULTIAPPBOOTLOADER EQU 3
CYDEV_PROJ_TYPE_STANDARD EQU 0
CYDEV_PROTECTION_ENABLE EQU 0
CYDEV_STACK_SIZE EQU 0x0800
CYDEV_USE_BUNDLED_CMSIS EQU 1
CYDEV_VARIABLE_VDDA EQU 0
CYDEV_VDDA_MV EQU 5000
CYDEV_VDDD_MV EQU 5000
CYDEV_VDDIO0_MV EQU 5000
CYDEV_VDDIO1_MV EQU 5000
CYDEV_VDDIO2_MV EQU 5000
CYDEV_VDDIO3_MV EQU 5000
CYDEV_VIO0_MV EQU 5000
CYDEV_VIO1_MV EQU 5000
CYDEV_VIO2_MV EQU 5000
CYDEV_VIO3_MV EQU 5000
CYIPBLOCK_ARM_CM3_VERSION EQU 0
CYIPBLOCK_P3_ANAIF_VERSION EQU 0
CYIPBLOCK_P3_CAN_VERSION EQU 0
CYIPBLOCK_P3_CAPSENSE_VERSION EQU 0
CYIPBLOCK_P3_COMP_VERSION EQU 0
CYIPBLOCK_P3_DECIMATOR_VERSION EQU 0
CYIPBLOCK_P3_DFB_VERSION EQU 0
CYIPBLOCK_P3_DMA_VERSION EQU 0
CYIPBLOCK_P3_DRQ_VERSION EQU 0
CYIPBLOCK_P3_DSM_VERSION EQU 0
CYIPBLOCK_P3_EMIF_VERSION EQU 0
CYIPBLOCK_P3_I2C_VERSION EQU 0
CYIPBLOCK_P3_LCD_VERSION EQU 0
CYIPBLOCK_P3_LPF_VERSION EQU 0
CYIPBLOCK_P3_OPAMP_VERSION EQU 0
CYIPBLOCK_P3_PM_VERSION EQU 0
CYIPBLOCK_P3_SCCT_VERSION EQU 0
CYIPBLOCK_P3_TIMER_VERSION EQU 0
CYIPBLOCK_P3_USB_VERSION EQU 0
CYIPBLOCK_P3_VIDAC_VERSION EQU 0
CYIPBLOCK_P3_VREF_VERSION EQU 0
CYIPBLOCK_S8_GPIO_VERSION EQU 0
CYIPBLOCK_S8_IRQ_VERSION EQU 0
CYIPBLOCK_S8_SAR_VERSION EQU 0
CYIPBLOCK_S8_SIO_VERSION EQU 0
CYIPBLOCK_S8_UDB_VERSION EQU 0
DMA_CHANNELS_USED__MASK0 EQU 0x00000000
CYDEV_BOOTLOADER_ENABLE EQU 0

#endif /* INCLUDED_CYFITTERIAR_INC */
